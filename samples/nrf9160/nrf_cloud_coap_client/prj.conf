## CMakeLists.txt
```
#
# Copyright (c) 2022 Nordic Semiconductor
#
# SPDX-License-Identifier: LicenseRef-Nordic-5-Clause
#

cmake_minimum_required(VERSION 3.20.0)

find_package(Zephyr REQUIRED HINTS $ENV{ZEPHYR_BASE})
project(nrf-cloud-coap-client)
find_program(ZCBOR zcbor REQUIRED)

# NORDIC SDK APP START
target_sources(app PRIVATE src/main.c)
# NORDIC SDK APP END

zephyr_include_directories(src)
```

## Kconfig
```
#
# Copyright (c) 2022 Nordic Semiconductor ASA
#
# SPDX-License-Identifier: LicenseRef-Nordic-5-Clause
#

menu "nRF Cloud CoAP client sample"

module = NRF_CLOUD_COAP_CLIENT
module-dep = LOG
module-str = nRF Cloud CoAP Client Sample
source "${ZEPHYR_BASE}/subsys/logging/Kconfig.template.log_config"
endmenu # Application sample

menu "Zephyr Kernel"
source "Kconfig.zephyr"
endmenu
```

## sample.yaml
```
sample:
  name: nRF Cloud CoAP client sample
tests:
  samples.nrf9160.nrf_cloud_coap_client:
    build_only: true
    platform_allow: nrf9160dk_nrf9160_ns
    integration_platforms:
      - nrf9160dk_nrf9160_ns
    tags: ci_build
```

## prj.conf
```kconfig
#
# Copyright (c) 2019 Nordic Semiconductor ASA
#
# SPDX-License-Identifier: LicenseRef-Nordic-5-Clause
#
# General config
CONFIG_HEAP_MEM_POOL_SIZE=16384
CONFIG_NEWLIB_LIBC=y
CONFIG_NEWLIB_LIBC_FLOAT_PRINTF=y

CONFIG_DK_LIBRARY=y

# Mbed TLS logs include %zu formatters, which are not handled by the nano
# version of newlib
CONFIG_NEWLIB_LIBC_NANO=n

# Main thread
CONFIG_MAIN_STACK_SIZE=4096
CONFIG_SYSTEM_WORKQUEUE_STACK_SIZE=3072

# Networking
CONFIG_NETWORKING=y
CONFIG_NET_NATIVE=n
CONFIG_NET_OFFLOAD=y
CONFIG_NET_CONFIG_NEED_IPV6=y
CONFIG_NET_IPV4=y
CONFIG_NET_SOCKETS=y
CONFIG_NET_SOCKETS_OFFLOAD=y
CONFIG_NET_SOCKETS_POSIX_NAMES=y

# LTE link control
CONFIG_LTE_LINK_CONTROL=y
CONFIG_LTE_AUTO_INIT_AND_CONNECT=n

# Modem library
CONFIG_NRF_MODEM_LIB=y
CONFIG_NRF_MODEM_LIB_LOG_FW_VERSION_UUID=n

# AT Host
CONFIG_UART_INTERRUPT_DRIVEN=y
CONFIG_UART_0_INTERRUPT_DRIVEN=y
CONFIG_AT_HOST_LIBRARY=y

# CoAP
CONFIG_COAP=y
CONFIG_COAP_EXTENDED_OPTIONS_LEN=y

# LTE link control
CONFIG_NET_L2_VIRTUAL=y

# Date/Time
CONFIG_DATE_TIME=y
CONFIG_DATE_TIME_AUTO_UPDATE=y
CONFIG_DATE_TIME_MODEM=y
CONFIG_DATE_TIME_NTP=n

CONFIG_ZCBOR=y

CONFIG_CJSON_LIB=y

CONFIG_FPU=y
CONFIG_CBPRINTF_FP_SUPPORT=y
```

## overlay-debug.conf
```kconfig
#
# Copyright (c) 2022 Nordic Semiconductor ASA
#
# SPDX-License-Identifier: LicenseRef-Nordic-5-Clause
#
# General config
CONFIG_DEBUG=y

# Logging
CONFIG_LOG=y
CONFIG_NRF_CLOUD_COAP_CLIENT_LOG_LEVEL_DBG=y
CONFIG_NRF_CLOUD_COAP_LOG_LEVEL_DBG=y
CONFIG_LTE_LINK_CONTROL_LOG_LEVEL_WRN=y
CONFIG_NET_LOG=y
CONFIG_NET_OFFLOAD_LOG_LEVEL_WRN=y
CONFIG_NET_UDP_LOG_LEVEL_INF=y
CONFIG_NET_SOCKETS_LOG_LEVEL_INF=y
CONFIG_NET_IF_LOG_LEVEL_INF=y
CONFIG_NET_CONFIG_LOG_LEVEL_INF=y
CONFIG_DNS_RESOLVER_LOG_LEVEL_INF=n
CONFIG_NET_CONTEXT_LOG_LEVEL_INF=y
CONFIG_COAP_LOG_LEVEL_INF=y
CONFIG_AT_HOST_LOG_LEVEL_INF=y
CONFIG_DATE_TIME_LOG_LEVEL_INF=y

CONFIG_LOG_PRINTK=y
CONFIG_LOG_MODE_IMMEDIATE=y
CONFIG_LOG_DEFAULT_LEVEL=3
CONFIG_LOG_FUNC_NAME_PREFIX_DBG=y
CONFIG_LOG_FUNC_NAME_PREFIX_INF=y
CONFIG_LOG_FUNC_NAME_PREFIX_WRN=y
CONFIG_LOG_FUNC_NAME_PREFIX_ERR=y

# Modem library
CONFIG_NRF_MODEM_LIB_TRACE=y

CONFIG_NRF_MODEM_LOG=n
#CONFIG_NRF_MODEM_LIB_LOG_LEVEL_DBG=y
CONFIG_NRF_CLOUD_LOG_LEVEL_DBG=y
```

## overlay-mbedtls.conf
```kconfig
#
# Copyright (c) 2022 Nordic Semiconductor ASA
#
# SPDX-License-Identifier: LicenseRef-Nordic-5-Clause
#
# General config
CONFIG_COAP_DTLS=y

# MbedTLS needs a larger stack for the system workqueue
CONFIG_MAIN_STACK_SIZE=3072
CONFIG_SYSTEM_WORKQUEUE_STACK_SIZE=3072
# MbedTLS needs a larger heap
CONFIG_HEAP_MEM_POOL_SIZE=16384

# Networking
CONFIG_NET_CONFIG_NEED_IPV6=y
CONFIG_NET_IPV4=y
CONFIG_NET_OFFLOAD=y
CONFIG_NET_SOCKETS=y
CONFIG_NET_SOCKETS_POSIX_NAMES=y
CONFIG_NET_SOCKETS_SOCKOPT_TLS=y
CONFIG_NET_SOCKETS_TLS_MAX_CONTEXTS=4
CONFIG_NET_SOCKETS_TLS_SET_MAX_FRAGMENT_LENGTH=y
CONFIG_NET_SOCKETS_ENABLE_DTLS=y

# Configure for offloaded UDP and non-offloaded TLS
CONFIG_NET_SOCKETS_OFFLOAD=y
CONFIG_NET_SOCKETS_OFFLOAD_PRIORITY=50
CONFIG_MODEM_KEY_MGMT=n
CONFIG_NET_NATIVE=y

# Modem info
CONFIG_MODEM_INFO=y
CONFIG_MODEM_INFO_ADD_DEVICE=y
CONFIG_MODEM_INFO_ADD_NETWORK=y
CONFIG_MODEM_INFO_ADD_DATE_TIME=n
CONFIG_MODEM_INFO_ADD_SIM=n
CONFIG_MODEM_INFO_ADD_SIM_ICCID=n
CONFIG_MODEM_INFO_ADD_SIM_IMSI=n
CONFIG_MODEM_INFO_ADD_BOARD=n

# AT Host
#CONFIG_UART_INTERRUPT_DRIVEN=n

# Select mbed TLS
CONFIG_MBEDTLS=y
CONFIG_MBEDTLS_TLS_VERSION_1_2=y
#CONFIG_MBEDTLS_LIBRARY_NRF_SECURITY=y

#CONFIG_NRF_SECURITY=n
#CONFIG_NORDIC_SECURITY_BACKEND=n
#CONFIG_MBEDTLS_BUILTIN=y
#CONFIG_MBEDTLS_LIBRARY_NRF_SECURITY=n
CONFIG_BUILD_WITH_TFM=n
#CONFIG_TFM_PROFILE_TYPE_MEDIUM=y
CONFIG_SPM=y

# MbedTLS changes
CONFIG_MBEDTLS_ENABLE_HEAP=y
CONFIG_MBEDTLS_HEAP_SIZE=10240
CONFIG_MBEDTLS_SSL_MAX_CONTENT_LEN=1500

# Customize the set of ciphers enabled to only that which is needed
CONFIG_MBEDTLS_CIPHER_CCM_ENABLED=y
CONFIG_MBEDTLS_CIPHER_ALL_ENABLED=n
CONFIG_MBEDTLS_CIPHER_AES_ENABLED=y
CONFIG_MBEDTLS_CIPHER_DES_ENABLED=n
CONFIG_MBEDTLS_MAC_ALL_ENABLED=n
CONFIG_MBEDTLS_ECP_ALL_ENABLED=n
CONFIG_MBEDTLS_X509_LIBRARY=n
CONFIG_MBEDTLS_KEY_EXCHANGE_ALL_ENABLED=n
CONFIG_MBEDTLS_KEY_EXCHANGE_RSA_ENABLED=n
CONFIG_MBEDTLS_KEY_EXCHANGE_PSK_ENABLED=y

# DTLS-specific settings
CONFIG_MBEDTLS_DTLS=y
CONFIG_MBEDTLS_SSL_DTLS_CONNECTION_ID=y
CONFIG_MBEDTLS_SSL_EXTENDED_MASTER_SECRET=y
CONFIG_MBEDTLS_SERVER_NAME_INDICATION=y

CONFIG_TLS_CREDENTIALS=y

# CoAP
CONFIG_COAP_EXTENDED_OPTIONS_LEN=y
# configure the following to a CoAP server to which your PSK has already
# been provisioned:
#CONFIG_COAP_SERVER_HOSTNAME=""

# Logging
CONFIG_MBEDTLS_DEBUG=y
#CONFIG_MBEDTLS_DEBUG_LEVEL=2
# Mbed TLS logs include %zu formatters, which are not handled by the nano
# version of newlib
#CONFIG_NEWLIB_LIBC_NANO=n
```

## overlay-nrf-mbedtls.conf
```kconfig
#
# Copyright (c) 2022 Nordic Semiconductor ASA
#
# SPDX-License-Identifier: LicenseRef-Nordic-5-Clause
#

#CONFIG_SPM=n

# General config
CONFIG_COAP_DTLS=y

# MbedTLS needs a larger stack for the system workqueue
CONFIG_SYSTEM_WORKQUEUE_STACK_SIZE=3072
# MbedTLS needs a larger heap
CONFIG_HEAP_MEM_POOL_SIZE=8192

# Networking
CONFIG_NET_SOCKETS_SOCKOPT_TLS=y
CONFIG_NET_SOCKETS_TLS_MAX_CONTEXTS=4
CONFIG_NET_SOCKETS_TLS_SET_MAX_FRAGMENT_LENGTH=y
CONFIG_NET_SOCKETS_ENABLE_DTLS=y

# Configure for offloaded UDP and non-offloaded TLS
CONFIG_NET_SOCKETS_OFFLOAD_PRIORITY=50
CONFIG_MODEM_KEY_MGMT=n
CONFIG_NET_NATIVE=y

# Modem info
CONFIG_MODEM_INFO=y
CONFIG_MODEM_INFO_ADD_DEVICE=y
CONFIG_MODEM_INFO_ADD_NETWORK=y
CONFIG_MODEM_INFO_ADD_DATE_TIME=n
CONFIG_MODEM_INFO_ADD_SIM=n
CONFIG_MODEM_INFO_ADD_SIM_ICCID=n
CONFIG_MODEM_INFO_ADD_SIM_IMSI=n
#CONFIG_MODEM_INFO_ADD_BOARD=n

# AT Host
#CONFIG_UART_INTERRUPT_DRIVEN=y

# Select mbed TLS
CONFIG_MBEDTLS=y
CONFIG_MBEDTLS_TLS_VERSION_1_2=y

CONFIG_MBEDTLS_LIBRARY_NRF_SECURITY=y
CONFIG_NRF_SECURITY_ADVANCED=y
CONFIG_NORDIC_SECURITY_BACKEND=y
CONFIG_MBEDTLS_ECDSA_C=n
CONFIG_MBEDTLS_ECDH_C=n

# TFM configuration
CONFIG_BUILD_WITH_TFM=y
#CONFIG_SPM=y
#CONFIG_BOOTLOADER_MCUBOOT=y
#CONFIG_TFM_MCUBOOT_IMAGE_NUMBER=1
# Currently IPC isn't supported with NCS mcuboot
#CONFIG_TFM_IPC=y
#CONFIG_TFM_BL2=n
#CONFIG_ENTROPY_CC3XX=y

# MbedTLS changes
CONFIG_MBEDTLS_ENABLE_HEAP=y
CONFIG_MBEDTLS_HEAP_SIZE=16384
CONFIG_MBEDTLS_SSL_IN_CONTENT_LEN=2048
CONFIG_MBEDTLS_SSL_OUT_CONTENT_LEN=2048


CONFIG_MBEDTLS_TLS_LIBRARY=y
CONFIG_MBEDTLS_X509_LIBRARY=y
CONFIG_MBEDTLS_PSA_CRYPTO_C=y
CONFIG_MBEDTLS_SHA1_C=y

# Customize the set of ciphers enabled to only that which is needed
CONFIG_MBEDTLS_CIPHER_CCM_ENABLED=y
CONFIG_MBEDTLS_CIPHER_ALL_ENABLED=y
CONFIG_MBEDTLS_CIPHER_AES_ENABLED=y
CONFIG_MBEDTLS_CIPHER_DES_ENABLED=y
CONFIG_MBEDTLS_MAC_ALL_ENABLED=y
#CONFIG_MBEDTLS_ECP_ALL_ENABLED=y
CONFIG_MBEDTLS_KEY_EXCHANGE_ALL_ENABLED=y
#CONFIG_MBEDTLS_KEY_EXCHANGE_RSA_ENABLED=n
#CONFIG_MBEDTLS_KEY_EXCHANGE_PSK_ENABLED=y
#CONFIG_MBEDTLS_KEY_EXCHANGE_ECDH_ECDSA_ENABLED=n
#CONFIG_MBEDTLS_KEY_EXCHANGE_ECDH_RSA_ENABLED=n
#CONFIG_MBEDTLS_KEY_EXCHANGE_DHE_RSA_ENABLED=n
#CONFIG_MBEDTLS_KEY_EXCHANGE_ECDHE_RSA_ENABLED=n
#CONFIG_MBEDTLS_KEY_EXCHANGE_ECDHE_ECDSA_ENABLED=n
#CONFIG_MBEDTLS_KEY_EXCHANGE_RSA_PSK_ENABLED=n
CONFIG_MBEDTLS_PK_PARSE_C=y

CONFIG_MBEDTLS_CIPHER_MODE_CBC=y
CONFIG_MBEDTLS_DHM_C=y

# DTLS-specific settings
CONFIG_MBEDTLS_DTLS=y
CONFIG_MBEDTLS_SSL_DTLS_CONNECTION_ID=y
CONFIG_MBEDTLS_SSL_EXTENDED_MASTER_SECRET=y
CONFIG_MBEDTLS_SSL_SERVER_NAME_INDICATION=y

CONFIG_TLS_CREDENTIALS=y

# CoAP
CONFIG_COAP_EXTENDED_OPTIONS_LEN=y
# configure the following to a CoAP server to which your PSK has already
# been provisioned (if using DTLS):
#CONFIG_COAP_SERVER_HOSTNAME=""

# Logging
CONFIG_MBEDTLS_DEBUG=y
CONFIG_MBEDTLS_DEBUG_C=y
CONFIG_MBEDTLS_DEBUG_LEVEL=3
CONFIG_NET_SOCKETS_LOG_LEVEL_INF=y
CONFIG_MBEDTLS_SSL_DEBUG_ALL=y
CONFIG_MBEDTLS_DEBUG_STRIP_NEWLINE=y
```

## overlay-offload-tls.conf
```kconfig
#
# Copyright (c) 2022 Nordic Semiconductor ASA
#
# SPDX-License-Identifier: LicenseRef-Nordic-5-Clause
#
# General config
CONFIG_NRF_CLOUD_COAP_DTLS=y
CONFIG_NRF_CLOUD_COAP_DTLS_CID=y

# Networking
#CONFIG_NET_SOCKETS_SOCKOPT_TLS=y
CONFIG_NET_SOCKETS_TLS_SET_MAX_FRAGMENT_LENGTH=y
#CONFIG_NET_SOCKETS_ENABLE_DTLS=y

# Configure for using offloaded UDP and TLS
CONFIG_NET_SOCKETS_OFFLOAD_PRIORITY=40
CONFIG_MODEM_KEY_MGMT=y

# Modem info
CONFIG_MODEM_INFO=y
CONFIG_MODEM_INFO_ADD_DEVICE=y
CONFIG_MODEM_INFO_ADD_NETWORK=y
CONFIG_MODEM_INFO_ADD_DATE_TIME=n
CONFIG_MODEM_INFO_ADD_SIM=n
CONFIG_MODEM_INFO_ADD_SIM_ICCID=n
CONFIG_MODEM_INFO_ADD_SIM_IMSI=n
#CONFIG_MODEM_INFO_ADD_BOARD=n

# AT Host
#CONFIG_UART_INTERRUPT_DRIVEN=n

# CoAP
CONFIG_COAP_EXTENDED_OPTIONS_LEN=y
# configure the following to a CoAP server to which your PSK has already
# been provisioned (if using DTLS):
#CONFIG_COAP_SERVER_HOSTNAME=""

# these need to match in offloaded mode
CONFIG_NRF_CLOUD_COAP_SEC_TAG=86
CONFIG_NRF_CLOUD_SEC_TAG=86
CONFIG_MODEM_JWT=y
```

## src/main.c
```c
/*
 * Copyright (c) 2022 Nordic Semiconductor ASA
 *
 * SPDX-License-Identifier: LicenseRef-Nordic-5-Clause
 */

#include <stdio.h>
#include <string.h>

#include <zephyr/kernel.h>
#include <zephyr/net/coap.h>
#include <zephyr/net/socket.h>
#include <modem/lte_lc.h>
#include <modem/modem_info.h>
#include <modem/nrf_modem_lib.h>
#include <zephyr/random/rand32.h>
#if defined(CONFIG_LWM2M_CARRIER)
#include <lwm2m_carrier.h>
#endif
#include <nrf_socket.h>
#include <nrf_modem_at.h>
#include <date_time.h>
#include <net/nrf_cloud.h>
#include <dk_buttons_and_leds.h>
//#include "nrf_cloud_codec.h"
#include "scan_wifi.h"
#include "nrf_cloud_coap.h"
#include "coap_client.h"
#include "coap_codec.h"
#include "dtls.h"

#include <zephyr/logging/log.h>
LOG_MODULE_REGISTER(nrf_cloud_coap_client, CONFIG_NRF_CLOUD_COAP_CLIENT_LOG_LEVEL);

#define CREDS_REQ_WAIT_SEC 10
#define APP_WAIT_CELLS_S 30

#define APP_COAP_JWT_ACK_WAIT_MS 120000
#define APP_COAP_SEND_INTERVAL_MS 10000
#define APP_COAP_CLOSE_THRESHOLD_MS 4000
#define APP_COAP_CONNECTION_CHECK_MS 30000
#define APP_COAP_INTERVAL_LIMIT 60

//#define COAP_POC

/* Uncomment to incrementally increase time between coap packets */
#define DELAY_INTERPACKET_PERIOD

/* Open and close socket every cycle */
/* #define OPEN_AND_SHUT */

#define BTN_NUM 1

/* Modem FW version required to properly run this sample */
#define MFWV_MAJ_SAMPLE_REQ	1
#define MFWV_MIN_SAMPLE_REQ	3
#define MFWV_REV_SAMPLE_REQ	0
/* Modem FW version required for extended neighbor cells search */
#define MFWV_MAJ_EXT_SRCH	1
#define MFWV_MIN_EXT_SRCH	3
#define MFWV_REV_EXT_SRCH	1
/* Modem FW version required for extended GCI neighbor cells search */
#define MFWV_MAJ_EXT_SRCH_GCI	1
#define MFWV_MIN_EXT_SRCH_GCI	3
#define MFWV_REV_EXT_SRCH_GCI	4

static char device_id[NRF_CLOUD_CLIENT_ID_MAX_LEN];

/* Type of data to be sent in the cellular positioning request */
enum nrf_cloud_location_type active_cell_pos_type = LOCATION_TYPE_SINGLE_CELL;

static bool authorized = false;

/* Search type used for neighbor cell measurements; modem FW version depenedent */
static enum lte_lc_neighbor_search_type search_type =
						  LTE_LC_NEIGHBOR_SEARCH_TYPE_GCI_EXTENDED_COMPLETE;

/* Buffer to hold neighbor cell measurement data for multi-cell requests */
static struct lte_lc_ncell neighbor_cells[CONFIG_LTE_NEIGHBOR_CELLS_MAX];

/* Buffer to hold GCI cell measurement data for multi-cell requests */
static struct lte_lc_cell gci_cells[5];

/* Modem info struct used for modem FW version and cell info used for single-cell requests */
static struct modem_param_info mdm_param;

/* Structure to hold all cell info */
static struct lte_lc_cells_info cell_info;

/* Current RRC mode */
static enum lte_lc_rrc_mode cur_rrc_mode = LTE_LC_RRC_MODE_IDLE;

/* Flag to indicate that a neighbor cell measurement should be taken once RRC mode is idle */
static bool request_cells = true;

static uint8_t agps_buf[4096];

/* Semaphore to indicate that cell info has been received */
static K_SEM_DEFINE(cell_info_ready_sem, 0, 1);

/* Mutex for cell info struct */
static K_MUTEX_DEFINE(cell_info_mutex);

/* Semaphore to indicate a button has been pressed */
static K_SEM_DEFINE(button_press_sem, 0, 1);

#if defined(CONFIG_WIFI)
/* Semaphore to indicate Wi-Fi scanning is complete */
static K_SEM_DEFINE(wifi_scan_sem, 0, 1);
#endif

static void get_cell_info(void);

static bool ver_check(int32_t reqd_maj, int32_t reqd_min, int32_t reqd_rev,
		      int32_t maj, int32_t min, int32_t rev)
{
	if (maj > reqd_maj) {
		return true;
	} else if ((maj == reqd_maj) && (min > reqd_min)) {
		return true;
	} else if ((maj == reqd_maj) && (min == reqd_min) && (rev >= reqd_rev)) {
		return true;
	}
	return false;
}

static void check_modem_fw_version(void)
{
	char mfwv_str[128];
	uint32_t major;
	uint32_t minor;
	uint32_t rev;

	if (modem_info_string_get(MODEM_INFO_FW_VERSION, mfwv_str, sizeof(mfwv_str)) <= 0) {
		LOG_WRN("Failed to get modem FW version");
		return;
	}

	LOG_INF("Modem FW version: %s", mfwv_str);

	if (sscanf(mfwv_str, "mfw_nrf9160_%u.%u.%u", &major, &minor, &rev) != 3) {
		LOG_WRN("Unable to parse modem FW version number");
		return;
	}

	/* Ensure the modem firmware version meets the requirement for this sample */
	if (!ver_check(MFWV_MAJ_SAMPLE_REQ, MFWV_MIN_SAMPLE_REQ, MFWV_REV_SAMPLE_REQ,
		       major, minor, rev)) {
		LOG_ERR("This sample requires modem FW version %d.%d.%d or later",
			MFWV_MAJ_SAMPLE_REQ, MFWV_MIN_SAMPLE_REQ, MFWV_REV_SAMPLE_REQ);
		LOG_INF("Update modem firmware and restart");
		k_sleep(K_FOREVER);
	}

	/* Enable GCI/extended search if modem fw version allows */
	if (ver_check(MFWV_MAJ_EXT_SRCH_GCI, MFWV_MIN_EXT_SRCH_GCI, MFWV_REV_EXT_SRCH_GCI,
		      major, minor, rev)) {
		search_type = LTE_LC_NEIGHBOR_SEARCH_TYPE_GCI_EXTENDED_COMPLETE;
		LOG_INF("Using LTE LC neighbor search type GCI extended complete for %d cells",
			ARRAY_SIZE(gci_cells));
	} else if (ver_check(MFWV_MAJ_EXT_SRCH, MFWV_MIN_EXT_SRCH, MFWV_REV_EXT_SRCH,
			     major, minor, rev)) {
		search_type = LTE_LC_NEIGHBOR_SEARCH_TYPE_EXTENDED_COMPLETE;
		LOG_INF("Using LTE LC neighbor search type extended complete");
	} else {
		LOG_INF("Using LTE LC neighbor search type default");
	}
}

static void button_handler(uint32_t button_states, uint32_t has_changed)
{
	if (has_changed & button_states & BIT(BTN_NUM - 1)) {
		LOG_DBG("Button %d pressed", BTN_NUM);
		k_sem_give(&button_press_sem);
	}
}

static bool offer_update_creds(void)
{
	int ret;
	bool update_creds = false;

	k_sem_reset(&button_press_sem);

	LOG_INF("---> Press button %d to update credentials in modem", BTN_NUM);
	LOG_INF("     Waiting %d seconds...", CREDS_REQ_WAIT_SEC);

	ret = k_sem_take(&button_press_sem, K_SECONDS(CREDS_REQ_WAIT_SEC));
	if (ret == 0) {
		update_creds = true;
		LOG_INF("Credentials will be updated");
	} else {
		if (ret != -EAGAIN) {
			LOG_ERR("k_sem_take error: %d", ret);
		}

		LOG_INF("Credentials will not be updated");
	}

	return update_creds;
}

#if defined(CONFIG_NRF_MODEM_LIB)
/**@brief Recoverable modem library error. */
void nrf_modem_recoverable_error_handler(uint32_t err)
{
	LOG_ERR("Modem library recoverable error: %u", (unsigned int)err);
}
#endif /* defined(CONFIG_NRF_MODEM_LIB) */

#if defined(CONFIG_LWM2M_CARRIER)
K_SEM_DEFINE(carrier_registered, 0, 1);

void lwm2m_carrier_event_handler(const lwm2m_carrier_event_t *event)
{
	switch (event->type) {
	case LWM2M_CARRIER_EVENT_BSDLIB_INIT:
		LOG_INF("LWM2M_CARRIER_EVENT_BSDLIB_INIT");
		break;
	case LWM2M_CARRIER_EVENT_CONNECT:
		LOG_INF("LWM2M_CARRIER_EVENT_CONNECT");
		break;
	case LWM2M_CARRIER_EVENT_DISCONNECT:
		LOG_INF("LWM2M_CARRIER_EVENT_DISCONNECT");
		break;
	case LWM2M_CARRIER_EVENT_READY:
		LOG_INF("LWM2M_CARRIER_EVENT_READY");
		k_sem_give(&carrier_registered);
		break;
	case LWM2M_CARRIER_EVENT_FOTA_START:
		LOG_INF("LWM2M_CARRIER_EVENT_FOTA_START");
		break;
	case LWM2M_CARRIER_EVENT_REBOOT:
		LOG_INF("LWM2M_CARRIER_EVENT_REBOOT");
		break;
	}
}
#endif /* defined(CONFIG_LWM2M_CARRIER) */

K_SEM_DEFINE(lte_ready, 0, 1);

static void lte_handler(const struct lte_lc_evt *const evt)
{
	switch (evt->type) {
	case LTE_LC_EVT_NW_REG_STATUS:
		if ((evt->nw_reg_status == LTE_LC_NW_REG_REGISTERED_HOME) ||
		    (evt->nw_reg_status == LTE_LC_NW_REG_REGISTERED_ROAMING)) {
			LOG_INF("Connected to LTE network");
			k_sem_give(&lte_ready);
		} else {
			LOG_INF("reg status %d", evt->nw_reg_status);
		}
		break;

	case LTE_LC_EVT_CELL_UPDATE:
		if (evt->cell.id == LTE_LC_CELL_EUTRAN_ID_INVALID) {
			break;
		}

		/* Get new info when cell ID changes */
		LOG_INF("Cell info changed");
		request_cells = true;
		get_cell_info();
		break;
	case LTE_LC_EVT_RRC_UPDATE:
		cur_rrc_mode = evt->rrc_mode;
		if (cur_rrc_mode == LTE_LC_RRC_MODE_IDLE) {
			LOG_INF("RRC mode: idle");
		} else {
			LOG_INF("RRC mode: connected");
		}
		if (request_cells && (cur_rrc_mode == LTE_LC_RRC_MODE_IDLE)) {
			get_cell_info();
		}
		break;
	case LTE_LC_EVT_NEIGHBOR_CELL_MEAS:
		if ((search_type < LTE_LC_NEIGHBOR_SEARCH_TYPE_GCI_DEFAULT) &&
		    (evt->cells_info.current_cell.id == LTE_LC_CELL_EUTRAN_ID_INVALID)) {
			LOG_WRN("Current cell ID not valid in neighbor cell measurement results");
			break;
		}

		(void)k_mutex_lock(&cell_info_mutex, K_FOREVER);
		/* Copy current cell information. */
		memcpy(&cell_info.current_cell,
		       &evt->cells_info.current_cell,
		       sizeof(cell_info.current_cell));

		/* Copy neighbor cell information if present. */
		cell_info.ncells_count = evt->cells_info.ncells_count;
		if ((evt->cells_info.ncells_count > 0) && (evt->cells_info.neighbor_cells)) {
			memcpy(neighbor_cells,
			       evt->cells_info.neighbor_cells,
			       sizeof(neighbor_cells[0]) * cell_info.ncells_count);
			LOG_INF("Received measurements for %u neighbor cells",
				cell_info.ncells_count);
		} else {
			LOG_WRN("No neighbor cells were measured");
		}

		/* Copy GCI cell information if present. */
		cell_info.gci_cells_count = evt->cells_info.gci_cells_count;
		if ((evt->cells_info.gci_cells_count > 0) && (evt->cells_info.gci_cells)) {
			memcpy(gci_cells,
			       evt->cells_info.gci_cells,
			       sizeof(gci_cells[0]) * cell_info.gci_cells_count);
			LOG_INF("Received measurements for %u GCI cells",
				cell_info.gci_cells_count);
		} else if (search_type == LTE_LC_NEIGHBOR_SEARCH_TYPE_GCI_EXTENDED_COMPLETE) {
			LOG_WRN("No GCI cells were measured");
		}

		(void)k_mutex_unlock(&cell_info_mutex);
		k_sem_give(&cell_info_ready_sem);

		break;
	default:
		LOG_DBG("LTE event %d (0x%x)", evt->type, evt->type);
		break;
	}
}


/**@brief Configures modem to provide LTE link. Blocks until link is
 * successfully established.
 */
static void modem_configure(void)
{
	int err;

	err = nrf_modem_lib_init();
	if (err) {
		LOG_ERR("Modem library initialization failed, error: %d", err);
		return;
	}

	lte_lc_register_handler(lte_handler);
#if defined(CONFIG_LTE_LINK_CONTROL)
#if defined(CONFIG_LWM2M_CARRIER)
	/* Wait for the LWM2M_CARRIER to configure the modem and
	 * start the connection.
	 */
	LOG_INF("Waiting for carrier registration...");
	k_sem_take(&carrier_registered, K_FOREVER);
	LOG_INF("Registered!");
#else /* defined(CONFIG_LWM2M_CARRIER) */
	LOG_INF("LTE Link Connecting ...");
	err = lte_lc_init_and_connect();
	__ASSERT(err == 0, "LTE link could not be established.");
	k_sem_take(&lte_ready, K_FOREVER);
	LOG_INF("LTE Link Connected!");
	err = lte_lc_psm_req(true);
	if (err) {
		LOG_ERR("Unable to enter PSM mode: %d", err);
	}

	err = nrf_modem_at_printf("AT+CEREG=5");
	if (err) {
		LOG_ERR("Can't subscribe to +CEREG events.");
	}

#endif /* defined(CONFIG_LWM2M_CARRIER) */
#endif /* defined(CONFIG_LTE_LINK_CONTROL) */
	/* Modem info library is used to obtain the modem FW version
	 * and network info for single-cell requests
	 */
	err = modem_info_init();
	if (err) {
		LOG_ERR("Modem info initialization failed, error: %d", err);
		return;
	}

	err = modem_info_params_init(&mdm_param);
	if (err) {
		LOG_ERR("Modem info params initialization failed, error: %d", err);
		return;
	}

	/* Check modem FW version */
	check_modem_fw_version();
}

static void check_connection(void)
{
#if !defined(DELAY_INTERPACKET_PERIOD) && (APP_COAP_SEND_INTERVAL_MS < APP_COAP_CONNECTION_CHECK_MS)
	return;
#endif

	static int64_t next_keep_serial_alive_time;
	char scratch_buf[256];
	int err;

	if (k_uptime_get() >= next_keep_serial_alive_time) {
		next_keep_serial_alive_time = k_uptime_get() + APP_COAP_CONNECTION_CHECK_MS;
		scratch_buf[0] = '\0';
		err = nrf_modem_at_cmd(scratch_buf, sizeof(scratch_buf), "%s", "AT%XMONITOR");
		LOG_INF("%s", scratch_buf);
		if (err) {
			LOG_ERR("Error on at cmd: %d", err);
		}
	}
}

int init(void)
{
	int err;

	/* Init the button */
	err = dk_buttons_init(button_handler);
	if (err) {
		LOG_ERR("Failed to initialize button: error: %d", err);
		return err;
	}

	err = client_provision(offer_update_creds());
	if (err) {
		LOG_ERR("Failed to provision credentials: %d", err);
		return err;
	}

	modem_configure();

	err = get_device_id(device_id, sizeof(device_id));
	if (err) {
		LOG_ERR("Error getting device id: %d", err);
		return err;
	}

#if defined(CONFIG_WIFI)
	err = scan_wifi_init();
	if (err) {
		LOG_ERR("Error initializing Wi-Fi scanning: %d", err);
		return err;
	}
#endif

	err = client_init();
	if (err) {
		LOG_ERR("Failed to initialize CoAP client: %d", err);
		return err;
	}

	err = nrf_cloud_coap_init(device_id);
	if (err) {
		LOG_ERR("Failed to initialize nRF Cloud CoAP library: %d", err);
	}
	return err;
}

static void get_cell_info(void)
{
	int err;

	if (!authorized || !request_cells) {
		return;
	}

	struct lte_lc_ncellmeas_params ncellmeas_params = {
		.search_type = search_type,
		.gci_count = ARRAY_SIZE(gci_cells)
	};

	/* Set the result buffers */
	cell_info.neighbor_cells = neighbor_cells;
	cell_info.gci_cells = gci_cells;

	LOG_INF("Requesting neighbor cell measurement");
	err = lte_lc_neighbor_cell_measurement(&ncellmeas_params);
	if (err) {
		LOG_ERR("Failed to start neighbor cell measurement, error: %d", err);
	} else {
		request_cells = false;
		LOG_INF("Waiting for measurement results...");
	}
}

int do_next_test(void)
{
	static double temp = 21.5;
	static int cur_test = 1;
	static struct nrf_cloud_gnss_pvt pvt = {
		.lat = 45.525616, .lon = -122.685978, .accuracy = 30};
	int err = 0;
	struct nrf_cloud_location_result result;
	struct nrf_cloud_fota_job_info job;
	struct nrf_cloud_rest_agps_request agps_request;
	struct nrf_modem_gnss_agps_data_frame agps_req;
	struct nrf_cloud_rest_agps_result agps_res;
	struct nrf_cloud_rest_pgps_request pgps_request;
	struct gps_pgps_request pgps_req;
	struct nrf_cloud_pgps_result pgps_res;
	struct wifi_scan_info *wifi_info = NULL;
	char host[64];
	char path[128];

	switch (cur_test) {
	case 1:
		LOG_INF("******** %d. Sending temperature", cur_test);
		err = nrf_cloud_coap_send_sensor(NRF_CLOUD_JSON_APPID_VAL_TEMP, temp);
		if (err) {
			LOG_ERR("Error sending sensor data: %d", err);
			break;
		}
		temp += 0.1;
		break;
	case 2:
		LOG_INF("******** %d. Getting pending FOTA job execution", cur_test);
		err = nrf_cloud_coap_get_current_fota_job(&job);
		if (err) {
			LOG_ERR("Failed to request pending FOTA job: %d", err);
		} else {
			LOG_INF("******** %d. Updating FOTA job status", cur_test);
			/* process the job */
			err = nrf_cloud_coap_fota_job_update(job.id, NRF_CLOUD_FOTA_REJECTED,
						"Connection to rest of NCS FOTA not yet enabled.");
			if (err) {
				LOG_ERR("Unable to reject job: %d", err);
			} else {
				LOG_WRN("Rejected job because FOTA not hooked up yet.");
			}
		}
		break;
	case 3:
		LOG_INF("******** %d. Getting A-GPS data", cur_test);
		memset(&agps_request, 0, sizeof(agps_request));
		memset(&agps_req, 0, sizeof(agps_req));
		agps_request.type = NRF_CLOUD_REST_AGPS_REQ_ASSISTANCE;
		agps_request.net_info = &cell_info;
		agps_request.agps_req = &agps_req;
		agps_req.data_flags = 0x3f;
		agps_req.sv_mask_alm = 0xffffffff;
		agps_req.sv_mask_ephe = 0xffffffff;
		agps_res.buf = agps_buf;
		agps_res.buf_sz = sizeof(agps_buf);
		err = nrf_cloud_coap_agps(&agps_request, &agps_res);
		if (err) {
			LOG_ERR("Failed to request A-GPS: %d", err);
		} else {
			/* Process the data once it arrives... */
		}
		break;
	case 4:
		LOG_INF("******** %d. Getting P-GPS data", cur_test);
		memset(&pgps_request, 0, sizeof(pgps_request));
		memset(&pgps_res, 0, sizeof(pgps_res));
		pgps_req.gps_day = 0;
		pgps_req.gps_time_of_day = 0;
		pgps_req.prediction_count = 4;
		pgps_req.prediction_period_min = 240;
		pgps_request.pgps_req = &pgps_req;
		pgps_res.host = host;
		pgps_res.host_sz = sizeof(host);
		pgps_res.path = path;
		pgps_res.path_sz = sizeof(path);
		err = nrf_cloud_coap_pgps(&pgps_request, &pgps_res);
		if (err) {
			LOG_ERR("Failed to request P-GPS: %d", err);
		} else {
			LOG_INF("P-GPS host:%s, path:%s", pgps_res.host, pgps_res.path);
		}
		break;
	case 5:
		LOG_INF("******** %d. Getting position", cur_test);
		LOG_INF("Waiting for neighbor cells..");
		err = k_sem_take(&cell_info_ready_sem, K_SECONDS(APP_WAIT_CELLS_S));
		if (err) {
			LOG_ERR("Timeout waiting for cells: %d", err);
			break;
		}
#if defined(CONFIG_WIFI)
		err = scan_wifi_start(&wifi_scan_sem);
		LOG_INF("Waiting for Wi-Fi scans...");
		k_sem_take(&wifi_scan_sem, K_FOREVER);
		if (err) {
			LOG_ERR("Error starting Wi-Fi scan: %d", err);
			break;
		}
		wifi_info = scan_wifi_results_get();
#endif

		(void)k_mutex_lock(&cell_info_mutex, K_FOREVER);

		if (cell_info.current_cell.id != LTE_LC_CELL_EUTRAN_ID_INVALID) {
			LOG_INF("Current cell info: Cell ID: %u, TAC: %u, MCC: %d, MNC: %d",
				cell_info.current_cell.id, cell_info.current_cell.tac,
				cell_info.current_cell.mcc, cell_info.current_cell.mnc);
		} else {
			LOG_WRN("No current serving cell available");
		}

		if (cell_info.ncells_count || cell_info.gci_cells_count) {
			LOG_INF("Performing multi-cell request with "
				"%u neighbor cells and %u GCI cells",
				cell_info.ncells_count, cell_info.gci_cells_count);
		} else {
			LOG_INF("Performing single-cell request");
		}

		err = nrf_cloud_coap_get_location(&cell_info, wifi_info, &result);
		(void)k_mutex_unlock(&cell_info_mutex);
		if (err) {
			LOG_ERR("Unable to get location: %d", err);
			break;
		} else {
			/* Process the returned location once it arrives */
			pvt.lat = result.lat;
			pvt.lon = result.lon;
			pvt.accuracy = result.unc;
		}
		request_cells = true;
		break;
	case 6:
		LOG_INF("******** %d. Sending GNSS PVT", cur_test);
		err = nrf_cloud_coap_send_gnss_pvt(&pvt);
		if (err) {
			LOG_ERR("Error sending GNSS PVT data: %d", err);
			break;
		}
		break;
	}

	if (++cur_test > 6) {
		cur_test = 1;
	}
	return err;
}


void main(void)
{
	int64_t next_msg_time;
	int delta_ms = APP_COAP_SEND_INTERVAL_MS;
	int err;
	int i = 1;
	bool reconnect = false;

	LOG_INF("\n");
	LOG_INF("The nRF Cloud CoAP client sample started\n");

	err = init();
	if (err) {
		LOG_ERR("Halting.");
		for (;;) {
		}
	}
	next_msg_time = k_uptime_get() + delta_ms;

	while (1) {
		if (authorized && (k_uptime_get() >= next_msg_time)) {
			if (reconnect) {
				reconnect = false;
				authorized = false;
				LOG_INF("Going online");
				err = lte_lc_normal();
				if (err) {
					LOG_ERR("Error going online: %d", err);
				} else {
					k_sem_take(&lte_ready, K_FOREVER);
					if (client_init() != 0) {
						LOG_ERR("Failed to initialize CoAP client");
						return;
					}
				}
			}

			err = do_next_test();
			if (err == -EAGAIN) {
				reconnect = true;
				err = client_close();
				if (err) {
					LOG_ERR("Error closing socket: %d", err);
				} else {
					LOG_INF("Socket closed.");
				}
				LOG_INF("Going offline");
				err = lte_lc_offline();
				if (err) {
					LOG_ERR("Error going offline: %d", err);
				} else {
					LOG_INF("Offline.");
				}
				continue;
			}

			delta_ms = APP_COAP_SEND_INTERVAL_MS * i;
			LOG_INF("Next transfer in %d minutes, %d seconds",
				delta_ms / 60000, (delta_ms / 1000) % 60);
			next_msg_time += delta_ms;
#if defined(DELAY_INTERPACKET_PERIOD)
			if (++i > APP_COAP_INTERVAL_LIMIT) {
				i = APP_COAP_INTERVAL_LIMIT;
			}
#endif
#if defined(CONFIG_COAP_DTLS) || defined(CONFIG_NRF_CLOUD_COAP_DTLS)
			dtls_print_connection_id(client_get_sock(), false);
#endif
		}

		if (!err && !authorized) {
			err = client_wait_ack(APP_COAP_JWT_ACK_WAIT_MS);
			if (!err) {
				LOG_INF("Authorization received");
				authorized = true;
				get_cell_info();
			}
		}
	}
	client_close();
}
```

## src/agps_encode.c
```c
/*
 * Generated using zcbor version 0.6.0
 * https://github.com/NordicSemiconductor/zcbor
 * Generated with a --default-max-qty of 3
 */

#include <stdint.h>
#include <stdbool.h>
#include <stddef.h>
#include <string.h>
#include "zcbor_encode.h"
#include "agps_encode.h"

#if DEFAULT_MAX_QTY != 3
#error "The type file was generated with a different default_max_qty than this file"
#endif

static bool encode_repeated_agps_req_customTypes(zcbor_state_t *state, const struct agps_req_customTypes_ *input);
static bool encode_repeated_agps_req_filtered(zcbor_state_t *state, const struct agps_req_filtered *input);
static bool encode_repeated_agps_req_mask(zcbor_state_t *state, const struct agps_req_mask *input);
static bool encode_repeated_agps_req_rsrp(zcbor_state_t *state, const struct agps_req_rsrp *input);
static bool encode_agps_req(zcbor_state_t *state, const struct agps_req *input);


static bool encode_repeated_agps_req_customTypes(
		zcbor_state_t *state, const struct agps_req_customTypes_ *input)
{
	zcbor_print("%s\r\n", __func__);
	struct zcbor_string tmp_str;

	bool tmp_result = ((((zcbor_tstr_encode(state, ((tmp_str.value = (uint8_t *)"customTypes", tmp_str.len = sizeof("customTypes") - 1, &tmp_str)))))
	&& (zcbor_list_start_encode(state, 10) && ((zcbor_multi_encode_minmax(1, 10, &(*input)._agps_req_customTypes_int_count, (zcbor_encoder_t *)zcbor_int32_encode, state, (&(*input)._agps_req_customTypes_int), sizeof(int32_t))) || (zcbor_list_map_end_force_encode(state), false)) && zcbor_list_end_encode(state, 10))));

	if (!tmp_result)
		zcbor_trace();

	return tmp_result;
}

static bool encode_repeated_agps_req_filtered(
		zcbor_state_t *state, const struct agps_req_filtered *input)
{
	zcbor_print("%s\r\n", __func__);
	struct zcbor_string tmp_str;

	bool tmp_result = ((((zcbor_tstr_encode(state, ((tmp_str.value = (uint8_t *)"filtered", tmp_str.len = sizeof("filtered") - 1, &tmp_str)))))
	&& (zcbor_bool_encode(state, (&(*input)._agps_req_filtered)))));

	if (!tmp_result)
		zcbor_trace();

	return tmp_result;
}

static bool encode_repeated_agps_req_mask(
		zcbor_state_t *state, const struct agps_req_mask *input)
{
	zcbor_print("%s\r\n", __func__);
	struct zcbor_string tmp_str;

	bool tmp_result = ((((zcbor_tstr_encode(state, ((tmp_str.value = (uint8_t *)"mask", tmp_str.len = sizeof("mask") - 1, &tmp_str)))))
	&& (zcbor_uint32_encode(state, (&(*input)._agps_req_mask)))));

	if (!tmp_result)
		zcbor_trace();

	return tmp_result;
}

static bool encode_repeated_agps_req_rsrp(
		zcbor_state_t *state, const struct agps_req_rsrp *input)
{
	zcbor_print("%s\r\n", __func__);
	struct zcbor_string tmp_str;

	bool tmp_result = ((((zcbor_tstr_encode(state, ((tmp_str.value = (uint8_t *)"rsrp", tmp_str.len = sizeof("rsrp") - 1, &tmp_str)))))
	&& (zcbor_int32_encode(state, (&(*input)._agps_req_rsrp)))));

	if (!tmp_result)
		zcbor_trace();

	return tmp_result;
}

static bool encode_agps_req(
		zcbor_state_t *state, const struct agps_req *input)
{
	zcbor_print("%s\r\n", __func__);
	struct zcbor_string tmp_str;

	bool tmp_result = (((zcbor_map_start_encode(state, 9) && ((zcbor_present_encode(&((*input)._agps_req_customTypes_present), (zcbor_encoder_t *)encode_repeated_agps_req_customTypes, state, (&(*input)._agps_req_customTypes))
	&& (((zcbor_tstr_encode(state, ((tmp_str.value = (uint8_t *)"eci", tmp_str.len = sizeof("eci") - 1, &tmp_str)))))
	&& (zcbor_uint32_encode(state, (&(*input)._agps_req_eci))))
	&& zcbor_present_encode(&((*input)._agps_req_filtered_present), (zcbor_encoder_t *)encode_repeated_agps_req_filtered, state, (&(*input)._agps_req_filtered))
	&& zcbor_present_encode(&((*input)._agps_req_mask_present), (zcbor_encoder_t *)encode_repeated_agps_req_mask, state, (&(*input)._agps_req_mask))
	&& (((zcbor_tstr_encode(state, ((tmp_str.value = (uint8_t *)"mcc", tmp_str.len = sizeof("mcc") - 1, &tmp_str)))))
	&& (zcbor_uint32_encode(state, (&(*input)._agps_req_mcc))))
	&& (((zcbor_tstr_encode(state, ((tmp_str.value = (uint8_t *)"mnc", tmp_str.len = sizeof("mnc") - 1, &tmp_str)))))
	&& (zcbor_uint32_encode(state, (&(*input)._agps_req_mnc))))
	&& (((zcbor_tstr_encode(state, ((tmp_str.value = (uint8_t *)"requestType", tmp_str.len = sizeof("requestType") - 1, &tmp_str)))))
	&& (zcbor_tstr_encode(state, (&(*input)._agps_req_requestType))))
	&& zcbor_present_encode(&((*input)._agps_req_rsrp_present), (zcbor_encoder_t *)encode_repeated_agps_req_rsrp, state, (&(*input)._agps_req_rsrp))
	&& (((zcbor_tstr_encode(state, ((tmp_str.value = (uint8_t *)"tac", tmp_str.len = sizeof("tac") - 1, &tmp_str)))))
	&& (zcbor_uint32_encode(state, (&(*input)._agps_req_tac))))) || (zcbor_list_map_end_force_encode(state), false)) && zcbor_map_end_encode(state, 9))));

	if (!tmp_result)
		zcbor_trace();

	return tmp_result;
}



int cbor_encode_agps_req(
		uint8_t *payload, size_t payload_len,
		const struct agps_req *input,
		size_t *payload_len_out)
{
	zcbor_state_t states[4];

	zcbor_new_state(states, sizeof(states) / sizeof(zcbor_state_t), payload, payload_len, 1);

	bool ret = encode_agps_req(states, input);

	if (ret && (payload_len_out != NULL)) {
		*payload_len_out = MIN(payload_len,
				(size_t)states[0].payload - (size_t)payload);
	}

	if (!ret) {
		int err = zcbor_pop_error(states);

		zcbor_print("Return error: %d\r\n", err);
		return (err == ZCBOR_SUCCESS) ? ZCBOR_ERR_UNKNOWN : err;
	}
	return ZCBOR_SUCCESS;
}
```

## src/agps_encode.h
```c
/*
 * Generated using zcbor version 0.6.0
 * https://github.com/NordicSemiconductor/zcbor
 * Generated with a --default-max-qty of 3
 */

#ifndef AGPS_ENCODE_H__
#define AGPS_ENCODE_H__

#include <stdint.h>
#include <stdbool.h>
#include <stddef.h>
#include <string.h>
#include "zcbor_encode.h"
#include "agps_encode_types.h"

#if DEFAULT_MAX_QTY != 3
#error "The type file was generated with a different default_max_qty than this file"
#endif


int cbor_encode_agps_req(
		uint8_t *payload, size_t payload_len,
		const struct agps_req *input,
		size_t *payload_len_out);


#endif /* AGPS_ENCODE_H__ */
```

## src/agps_encode_types.h
```c
/*
 * Generated using zcbor version 0.6.0
 * https://github.com/NordicSemiconductor/zcbor
 * Generated with a --default-max-qty of 3
 */

#ifndef AGPS_ENCODE_TYPES_H__
#define AGPS_ENCODE_TYPES_H__

#include <stdint.h>
#include <stdbool.h>
#include <stddef.h>
#include <string.h>
#include "zcbor_encode.h"

/** Which value for --default-max-qty this file was created with.
 *
 *  The define is used in the other generated file to do a build-time
 *  compatibility check.
 *
 *  See `zcbor --help` for more information about --default-max-qty
 */
#define DEFAULT_MAX_QTY 3

struct agps_req_customTypes_ {
	int32_t _agps_req_customTypes_int[10];
	uint_fast32_t _agps_req_customTypes_int_count;
};

struct agps_req_filtered {
	bool _agps_req_filtered;
};

struct agps_req_mask {
	uint32_t _agps_req_mask;
};

struct agps_req_rsrp {
	int32_t _agps_req_rsrp;
};

struct agps_req {
	struct agps_req_customTypes_ _agps_req_customTypes;
	uint_fast32_t _agps_req_customTypes_present;
	uint32_t _agps_req_eci;
	struct agps_req_filtered _agps_req_filtered;
	uint_fast32_t _agps_req_filtered_present;
	struct agps_req_mask _agps_req_mask;
	uint_fast32_t _agps_req_mask_present;
	uint32_t _agps_req_mcc;
	uint32_t _agps_req_mnc;
	struct zcbor_string _agps_req_requestType;
	struct agps_req_rsrp _agps_req_rsrp;
	uint_fast32_t _agps_req_rsrp_present;
	uint32_t _agps_req_tac;
};


#endif /* AGPS_ENCODE_TYPES_H__ */
```

## src/agps_fetch_encode.h
```c
/*
 * Generated using zcbor version 0.6.0
 * https://github.com/NordicSemiconductor/zcbor
 * Generated with a --default-max-qty of 10
 */

#ifndef AGPS_FETCH_ENCODE_H__
#define AGPS_FETCH_ENCODE_H__

#include <stdint.h>
#include <stdbool.h>
#include <stddef.h>
#include <string.h>
#include "zcbor_encode.h"
#include "agps_fetch_encode_types.h"

#if DEFAULT_MAX_QTY != 10
#error "The type file was generated with a different default_max_qty than this file"
#endif


int cbor_encode_agps(
		uint8_t *payload, size_t payload_len,
		const struct agps *input,
		size_t *payload_len_out);


#endif /* AGPS_FETCH_ENCODE_H__ */
```

## src/agps_fetch_encode_types.h
```c
/*
 * Generated using zcbor version 0.6.0
 * https://github.com/NordicSemiconductor/zcbor
 * Generated with a --default-max-qty of 10
 */

#ifndef AGPS_FETCH_ENCODE_TYPES_H__
#define AGPS_FETCH_ENCODE_TYPES_H__

#include <stdint.h>
#include <stdbool.h>
#include <stddef.h>
#include <string.h>
#include "zcbor_encode.h"

/** Which value for --default-max-qty this file was created with.
 *
 *  The define is used in the other generated file to do a build-time
 *  compatibility check.
 *
 *  See `zcbor --help` for more information about --default-max-qty
 */
#define DEFAULT_MAX_QTY 10

struct customTypes {
	uint32_t _customTypes_val;
};

struct eci {
	uint32_t _eci_val;
};

struct filtered {
	bool _filtered_val;
};

struct mask {
	uint32_t _mask_val;
};

struct mcc {
	uint32_t _mcc_val;
};

struct mnc {
	union {
		struct zcbor_string _mnc_val_tstr;
		int32_t _mnc_val_int;
	};
	enum {
		_mnc_val_tstr,
		_mnc_val_int,
	} _mnc_val_choice;
};

struct requestType {
	enum {
		_requestType_val_rtLocation_tstr,
		_requestType_val_rtAssistance_tstr,
		_requestType_val_custom_tstr,
	} _requestType_val_choice;
};

struct rsrp {
	int32_t _rsrp_val;
};

struct tac {
	uint32_t _tac_val;
};

struct agps_type_ {
	union {
		struct customTypes _agps_type__customTypes;
		struct eci _agps_type__eci;
		struct filtered _agps_type__filtered;
		struct mask _agps_type__mask;
		struct mcc _agps_type__mcc;
		struct mnc _agps_type__mnc;
		struct requestType _agps_type__requestType;
		struct rsrp _agps_type__rsrp;
		struct tac _agps_type__tac;
	};
	enum {
		_agps_type__customTypes,
		_agps_type__eci,
		_agps_type__filtered,
		_agps_type__mask,
		_agps_type__mcc,
		_agps_type__mnc,
		_agps_type__requestType,
		_agps_type__rsrp,
		_agps_type__tac,
	} _agps_type_choice;
};

struct agps {
	struct agps_type_ __agps_type[10];
	uint_fast32_t __agps_type_count;
};


#endif /* AGPS_FETCH_ENCODE_TYPES_H__ */
```

## src/app_jwt.c
```c
#include <stdio.h>
#include <string.h>

#include <zephyr/kernel.h>
#include <modem/modem_jwt.h>
#include <nrf_modem_at.h>
#include <date_time.h>
#include <net/nrf_cloud.h>
#include <psa/crypto.h>
#include <psa/crypto_extra.h>
#ifdef CONFIG_BUILD_WITH_TFM
#include <tfm_ns_interface.h>
#endif
#include <zephyr/sys/base64.h>
#include <cJSON.h>
#include "cJSON_os.h"

#include "app_jwt.h"

#include <zephyr/logging/log.h>
LOG_MODULE_REGISTER(app_jwt, CONFIG_NRF_CLOUD_COAP_CLIENT_LOG_LEVEL);

#define JWT_BUF_SZ	900

#if 0
static psa_key_handle_t keypair_handle;
static psa_key_handle_t pub_key_handle;
#endif

int app_jwt_init(void)
{
#if defined(CONFIG_NET_SOCKETS_ENABLE_DTLS)
	cJSON_Init();

	psa_status_t status;

	/* Initialize PSA Crypto */
	status = psa_crypto_init();
	if (status != PSA_SUCCESS) {
		return -1;
	}
#endif
	return 0;
}

#if 0
int import_ecdsa_pub_key(uint8_t *m_pub_key, size_t len_pub_key)
{
	/* Configure the key attributes */
	psa_key_attributes_t key_attributes = PSA_KEY_ATTRIBUTES_INIT;
	psa_status_t status;

	/* Configure the key attributes */
	psa_set_key_usage_flags(&key_attributes, PSA_KEY_USAGE_VERIFY_HASH);
	psa_set_key_lifetime(&key_attributes, PSA_KEY_LIFETIME_VOLATILE);
	psa_set_key_algorithm(&key_attributes, PSA_ALG_ECDSA(PSA_ALG_SHA_256));
	psa_set_key_type(&key_attributes, PSA_KEY_TYPE_ECC_PUBLIC_KEY(PSA_ECC_FAMILY_SECP_R1));
	psa_set_key_bits(&key_attributes, 256);

	status = psa_import_key(&key_attributes, m_pub_key, sizeof(m_pub_key), &pub_key_handle);
	if (status != PSA_SUCCESS) {
		LOG_INF("psa_import_key failed! (Error: %d)", status);
		return -1;
	}

	/* After the key handle is acquired the attributes are not needed */
	psa_reset_key_attributes(&key_attributes);

	return 0;
}

int sign_message(void)
{
	uint32_t output_len;
	psa_status_t status;

	LOG_INF("Signing a message using ECDSA...");

	/* Compute the SHA256 hash*/
	status = psa_hash_compute(PSA_ALG_SHA_256,
				  m_plain_text,
				  sizeof(m_plain_text),
				  m_hash,
				  sizeof(m_hash),
				  &output_len);
	if (status != PSA_SUCCESS) {
		LOG_INF("psa_hash_compute failed! (Error: %d)", status);
		return -1;
	}

	/* Sign the hash */
	status = psa_sign_hash(keypair_handle,
			       PSA_ALG_ECDSA(PSA_ALG_SHA_256),
			       m_hash,
			       sizeof(m_hash),
			       m_signature,
			       sizeof(m_signature),
			       &output_len);
	if (status != PSA_SUCCESS) {
		LOG_INF("psa_sign_hash failed! (Error: %d)", status);
		return -1;
	}

	LOG_INF("Signing the message successful!");
	PRINT_HEX("Plaintext", m_plain_text, sizeof(m_plain_text));
	PRINT_HEX("SHA256 hash", m_hash, sizeof(m_hash));
	PRINT_HEX("Signature", m_signature, sizeof(m_signature));

	return 0;
}
#endif

#if defined(CONFIG_NET_SOCKETS_ENABLE_DTLS)
static void base64_url_format(char *const base64_string)
{
	if (base64_string == NULL) {
		return;
	}

	char *found = NULL;

	/* replace '+' with "-" */
	for (found = base64_string; (found = strchr(found, '+'));) {
		*found = '-';
	}

	/* replace '/' with "_" */
	for (found = base64_string; (found = strchr(found, '/'));) {
		*found = '_';
	}

	/* remove padding '=' */
	found = strchr(base64_string, '=');
	if (found) {
		*found = '\0';
	}
}
#endif

int app_jwt_generate(uint32_t time_valid_s, char *const jwt_buf, size_t jwt_buf_sz)
{
	int err;

	if (!jwt_buf || !jwt_buf_sz) {
		return -EINVAL;
	}

#if !defined(CONFIG_NET_SOCKETS_ENABLE_DTLS)
	err = nrf_cloud_jwt_generate(time_valid_s, jwt_buf, jwt_buf_sz);
	if (err) {
		LOG_ERR("Error generating JWT with modem: %d", err);
	}
#else
	#define GET_TIME_CMD "AT%%CCLK?"
	char buf[NRF_CLOUD_CLIENT_ID_MAX_LEN + 1];
	struct jwt_data jwt = {
		.audience = NULL,
		.sec_tag = CONFIG_COAP_SECTAG,
		.key = JWT_KEY_TYPE_CLIENT_PRIV,
		.alg = JWT_ALG_TYPE_ES256,
		.jwt_buf = jwt_buf,
		.jwt_sz = jwt_buf_sz
	};

	/* Check if modem time is valid */
	err = nrf_modem_at_cmd(buf, sizeof(buf), GET_TIME_CMD);
	if (err != 0) {
		LOG_ERR("Modem does not have valid date/time, JWT not generated");
		return -ETIME;
	}

	if (time_valid_s > NRF_CLOUD_JWT_VALID_TIME_S_MAX) {
		jwt.exp_delta_s = NRF_CLOUD_JWT_VALID_TIME_S_MAX;
	} else if (time_valid_s == 0) {
		jwt.exp_delta_s = NRF_CLOUD_JWT_VALID_TIME_S_DEF;
	} else {
		jwt.exp_delta_s = time_valid_s;
	}

	if (IS_ENABLED(CONFIG_NRF_CLOUD_CLIENT_ID_SRC_INTERNAL_UUID)) {
		/* The UUID is present in the iss claim, so there is no need
		 * to also include it in the sub claim.
		 */
		jwt.subject = NULL;
	} else {
		err = nrf_cloud_client_id_get(buf, sizeof(buf));
		if (err) {
			LOG_ERR("Failed to obtain client id, error: %d", err);
			return err;
		}
		jwt.subject = buf;
	}

	cJSON *header_obj = cJSON_CreateObject();

	if ((cJSON_AddStringToObjectCS(header_obj, "alg", "ES256") == NULL) ||
	    (cJSON_AddStringToObjectCS(header_obj, "typ", "JWT") == NULL)) {
		err = -ENOMEM;
		LOG_ERR("Unable to render json: %d", err);
		cJSON_Delete(header_obj);
		return err;
	}
	char *header = cJSON_PrintUnformatted(header_obj);
	
	if (header == NULL) {
		err = -ENOMEM;
		LOG_ERR("Unable to render json: %d", err);
		cJSON_Delete(header_obj);
		return err;
	}

	cJSON_Delete(header_obj);

	int64_t now;
	cJSON *payload_obj = cJSON_CreateObject();

	date_time_now(&now);
	now /= 1000;

	if (jwt.subject) {
		if (cJSON_AddStringToObjectCS(payload_obj, "sub", jwt.subject) == NULL) {
			err = -ENOMEM;
			LOG_ERR("Unable to render json: %d", err);
			cJSON_Delete(payload_obj);
			return err;
		}
	}
	if ((cJSON_AddNumberToObjectCS(payload_obj, "iat", now) == NULL) ||
	    (cJSON_AddNumberToObjectCS(payload_obj, "exp", now + jwt.exp_delta_s) == NULL)) {
		err = -ENOMEM;
		LOG_ERR("Unable to render json: %d", err);
		cJSON_Delete(payload_obj);
		return err;
	}
	/* iss field contains "nRF9160.<device uuid>" */

	char *payload = cJSON_PrintUnformatted(payload_obj);

	if (payload == NULL) {
		err = -ENOMEM;
		LOG_ERR("Unable to render json: %d", err);
		cJSON_Delete(payload_obj);
		return err;
	}

	cJSON_Delete(payload_obj);

	size_t hlen;
	size_t plen;

	base64_encode(NULL, 0, &hlen, header, strlen(header));
	base64_encode(NULL, 0, &plen, payload, strlen(payload));

	char *msg = k_malloc(hlen + 1 + plen + 1);

	base64_encode(msg, hlen, &hlen, header, strlen(header));
	msg[hlen] = '.';
	base64_encode(&msg[hlen + 1], plen, &plen, payload, strlen(payload));
	msg[hlen + 1 + plen] = '\0';

	base64_url_format(msg);

	if (err) {
		LOG_ERR("Failed to generate JWT, error: %d", err);
	}
#endif
	return err;
}

/*
JWT: eyJ0eXAiOiJKV1QiLCJhbGciOiJFUzI1NiIsImtpZCI6IjA3MDM3NWJkMjQxMTNlOGI4MzM4ZWRiZjUxZDg1NDliMjhjYTBlZjIwMmIxNjA0NGVlOGZjY2EyMjE1NDBiZDYifSAg.eyJpc3MiOiJuUkY5MTYwLjUwNGU1MzUzLTM4MzEtNDVjOC04MDBhLTI3MTlkOGJhMzlmNSIsImp0aSI6Im5SRjkxNjAuZjZlM2JkN2ItN2RmMy00Yjg4LWI0M2EtYTdhOTc2NmEwNGFkLjJmNzM1M2UwYTdkMzMzNWE0N2NmYjFhZDdlM2U5YWNiIiwiaWF0IjoxNjc2OTMwMzU4LCJleHAiOjE2NzY5MzA2NTgsInN1YiI6Im5yZi0zNTI2NTYxMDYxMDgxNDgifSAg.uv7rse7I4-peOgYU2twZc9HpItQU4K3JBYc7vEXPK7S7oLTvfDBoP_63T1J5EIquXLmCTmSTXLPEVcMkJm24FQ
 
header: {
  "typ": "JWT",
  "alg": "ES256",
  "kid": "070375bd24113e8b8338edbf51d8549b28ca0ef202b16044ee8fcca221540bd6"
}

payload: {
  "iss": "nRF9160.504e5353-3831-45c8-800a-2719d8ba39f5",
  "jti": "nRF9160.f6e3bd7b-7df3-4b88-b43a-a7a9766a04ad.2f7353e0a7d3335a47cfb1ad7e3e9acb",
  "iat": 1676930358,
  "exp": 1676930658,
  "sub": "nrf-352656106108148"
}

verify signature:
ECDSASHA256(
  base64UrlEncode(header) + "." +
  base64UrlEncode(payload),
  Public Key in SPKI, PKCS #1, X.509 Certificate, or JWK string format.
  ,
  Private Key in PKCS #8, PKCS #1, or JWK string format. The key never leaves your browser.
)

NOTE:
- omit iss if using sub
- exp = expiration time after which should not be used
- iat = issued at -- time it was issued
- jti = jwt id; must be unique to prevent replay
- kid = key id to perform key lookup
*/
```

## src/ca_cert.h
```c
  0x30, 0x82, 0x01, 0x80, 0x30, 0x82, 0x01, 0x26, 0xa0, 0x03, 0x02, 0x01,
  0x02, 0x02, 0x04, 0x62, 0xa1, 0xe0, 0x27, 0x30, 0x0a, 0x06, 0x08, 0x2a,
  0x86, 0x48, 0xce, 0x3d, 0x04, 0x03, 0x02, 0x30, 0x3f, 0x31, 0x0b, 0x30,
  0x09, 0x06, 0x03, 0x55, 0x04, 0x06, 0x13, 0x02, 0x46, 0x49, 0x31, 0x1d,
  0x30, 0x1b, 0x06, 0x03, 0x55, 0x04, 0x0a, 0x0c, 0x14, 0x4e, 0x6f, 0x72,
  0x64, 0x69, 0x63, 0x20, 0x53, 0x65, 0x6d, 0x69, 0x63, 0x6f, 0x6e, 0x64,
  0x75, 0x63, 0x74, 0x6f, 0x72, 0x31, 0x11, 0x30, 0x0f, 0x06, 0x03, 0x55,
  0x04, 0x03, 0x0c, 0x08, 0x54, 0x65, 0x73, 0x74, 0x43, 0x41, 0x2d, 0x31,
  0x30, 0x1e, 0x17, 0x0d, 0x32, 0x32, 0x30, 0x36, 0x30, 0x39, 0x31, 0x31,
  0x35, 0x37, 0x32, 0x37, 0x5a, 0x17, 0x0d, 0x33, 0x32, 0x30, 0x36, 0x30,
  0x39, 0x31, 0x31, 0x35, 0x37, 0x32, 0x37, 0x5a, 0x30, 0x3f, 0x31, 0x0b,
  0x30, 0x09, 0x06, 0x03, 0x55, 0x04, 0x06, 0x13, 0x02, 0x46, 0x49, 0x31,
  0x1d, 0x30, 0x1b, 0x06, 0x03, 0x55, 0x04, 0x0a, 0x0c, 0x14, 0x4e, 0x6f,
  0x72, 0x64, 0x69, 0x63, 0x20, 0x53, 0x65, 0x6d, 0x69, 0x63, 0x6f, 0x6e,
  0x64, 0x75, 0x63, 0x74, 0x6f, 0x72, 0x31, 0x11, 0x30, 0x0f, 0x06, 0x03,
  0x55, 0x04, 0x03, 0x0c, 0x08, 0x54, 0x65, 0x73, 0x74, 0x43, 0x41, 0x2d,
  0x31, 0x30, 0x59, 0x30, 0x13, 0x06, 0x07, 0x2a, 0x86, 0x48, 0xce, 0x3d,
  0x02, 0x01, 0x06, 0x08, 0x2a, 0x86, 0x48, 0xce, 0x3d, 0x03, 0x01, 0x07,
  0x03, 0x42, 0x00, 0x04, 0x82, 0x43, 0x92, 0xb2, 0xc0, 0x74, 0xc6, 0x7d,
  0xba, 0x0f, 0xe3, 0x45, 0x0f, 0x8e, 0xf7, 0xc4, 0x08, 0xa0, 0xf5, 0xb6,
  0x6b, 0x33, 0x18, 0x27, 0x15, 0x85, 0xa1, 0xcd, 0xf0, 0x7f, 0xc9, 0x94,
  0x36, 0x81, 0xf4, 0x27, 0xe8, 0x69, 0x72, 0xa0, 0x46, 0x3d, 0x01, 0x95,
  0x2d, 0xe5, 0xb5, 0xa1, 0xba, 0x28, 0x8e, 0xd6, 0xce, 0xb8, 0xe4, 0x30,
  0xae, 0x79, 0xde, 0x87, 0x80, 0x11, 0x7c, 0x42, 0xa3, 0x10, 0x30, 0x0e,
  0x30, 0x0c, 0x06, 0x03, 0x55, 0x1d, 0x13, 0x04, 0x05, 0x30, 0x03, 0x01,
  0x01, 0xff, 0x30, 0x0a, 0x06, 0x08, 0x2a, 0x86, 0x48, 0xce, 0x3d, 0x04,
  0x03, 0x02, 0x03, 0x48, 0x00, 0x30, 0x45, 0x02, 0x20, 0x77, 0x1f, 0xc4,
  0xc8, 0x01, 0x37, 0x71, 0xac, 0x79, 0xc4, 0xba, 0xde, 0xec, 0xf8, 0x49,
  0x57, 0x2c, 0xbc, 0x83, 0xd9, 0x65, 0xf3, 0x13, 0x1d, 0xe1, 0x71, 0x68,
  0x6d, 0xb6, 0xd5, 0x0e, 0xe1, 0x02, 0x21, 0x00, 0xa2, 0x6c, 0x33, 0xdb,
  0xb7, 0xbe, 0xc0, 0x3d, 0xb7, 0x6c, 0x02, 0x25, 0xa2, 0x1b, 0x9b, 0x8b,
  0x66, 0xcc, 0x1b, 0x00, 0x7f, 0x09, 0x15, 0x03, 0xf1, 0x1f, 0x8c, 0x10,
  0x70, 0x4e, 0xf5, 0x1d
```
