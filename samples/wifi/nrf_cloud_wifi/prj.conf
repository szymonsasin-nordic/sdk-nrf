## CMakeLists.txt
```
# SPDX-License-Identifier: Apache-2.0

cmake_minimum_required(VERSION 3.20.0)

find_package(Zephyr HINTS $ENV{ZEPHYR_BASE})
project(nrf_cloud_wifi)

target_sources(app PRIVATE src/main.c src/libc_support.c)

if(CONFIG_EXTERNAL_LIBC)
				message("external libc")
				zephyr_include_directories(
								$ENV{ESPRESSIF_TOOLCHAIN_PATH}/xtensa-esp32-elf/include
								$ENV{ESPRESSIF_TOOLCHAIN_PATH}/xtensa-esp32-elf/sys-include
							)
				target_link_options(
								zephyr_interface BEFORE INTERFACE
								-L$ENV{ESPRESSIF_TOOLCHAIN_PATH}/xtensa-esp32-elf/lib
								)

				zephyr_link_libraries(
								c nosys
								)
				zephyr_compile_options(
								--specs=nosys.specs
								)
else()
				message("zephyr minimal libc")
				zephyr_library_sources_ifdef(
					CONFIG_SOC_ESP32
					src/scanf.c
					src/atob.c
					src/strtod.c
				)
endif()
```

## Kconfig
```
#
# Copyright (c) 2020 Nordic Semiconductor ASA
#
# SPDX-License-Identifier: LicenseRef-Nordic-5-Clause
#

menu "nRF Cloud WiFi Sample Settings"

config CLOUD_MESSAGE
	string "Custom message published periodically to cloud"
	default "{\"state\":{\"reported\":{\"message\":\"Hello Internet of Things!\"}}}"

endmenu

menu "Zephyr Kernel"
source "Kconfig.zephyr"
endmenu

module = NRF_CLOUD_WIFI_SAMPLE
module-str = nRF Cloud WiFi sample
source "${ZEPHYR_BASE}/subsys/logging/Kconfig.template.log_config"
```

## sample.yaml
```
sample:
  name: nRF Cloud WiFi
tests:
  sample.board.esp32:
    platform_allow: esp32
    tags: esp32
```

## prj.conf
```kconfig
CONFIG_LOG=y
CONFIG_LOG_PRINTK=y

CONFIG_HEAP_MEM_POOL_SIZE=98304
CONFIG_MAIN_STACK_SIZE=4096
CONFIG_MINIMAL_LIBC_MALLOC_ARENA_SIZE=16384
#CONFIG_EXTERNAL_LIBC=y
CONFIG_TEST_RANDOM_GENERATOR=y
# disable below 3 lines when using ESP32
# CONFIG_NEWLIB_LIBC=y
# CONFIG_NEWLIB_LIBC_FLOAT_PRINTF=y
# CONFIG_EXTERNAL_LIBC=y

CONFIG_WIFI=y
CONFIG_WIFI_ESP32=y

CONFIG_NETWORKING=y
CONFIG_NET_L2_ETHERNET=y

CONFIG_NET_TCP=y
CONFIG_NET_IPV6=n
CONFIG_NET_IPV4=y
CONFIG_NET_DHCPV4=y

CONFIG_NET_MGMT=y
CONFIG_NET_MGMT_EVENT=y

CONFIG_NET_LOG=y
CONFIG_NET_CONTEXT_LOG_LEVEL_INF=y
CONFIG_NET_SHELL=n

CONFIG_NET_SOCKETS_SOCKOPT_TLS=y

# enable DNS resolver so getaddrinfo() will work
CONFIG_DNS_RESOLVER=y
CONFIG_DNS_RESOLVER_LOG_LEVEL_DBG=y

CONFIG_MQTT_LIB_TLS=y
CONFIG_MQTT_LOG_LEVEL_INF=y

# TLS configuration
CONFIG_MBEDTLS=y
CONFIG_MBEDTLS_BUILTIN=y
CONFIG_MBEDTLS_ENABLE_HEAP=y

CONFIG_MBEDTLS_DEBUG=y
CONFIG_MBEDTLS_DEBUG_LEVEL=4

CONFIG_MBEDTLS_SSL_MAX_CONTENT_LEN=5000
CONFIG_MBEDTLS_HEAP_SIZE=30720

CONFIG_MBEDTLS_ENTROPY_ENABLED=y
CONFIG_MBEDTLS_KEY_EXCHANGE_ECDHE_ECDSA_ENABLED=y
CONFIG_MBEDTLS_ECP_ALL_ENABLED=y
CONFIG_MBEDTLS_SERVER_NAME_INDICATION=y

# from SLM
CONFIG_NET_SOCKETS_TLS_MAX_CONTEXTS=2
CONFIG_POSIX_MAX_FDS=10

CONFIG_ESP32_WIFI_SSID="NordicPDX"
CONFIG_ESP32_WIFI_PASSWORD="BillionBluetooth"

# nRF Cloud
CONFIG_NRF_CLOUD_MQTT=y
CONFIG_NRF_CLOUD_CONNECTION_POLL_THREAD=y
CONFIG_NRF_CLOUD_FOTA=n
CONFIG_NRF_CLOUD_SEC_TAG=1
CONFIG_NRF_CLOUD_LOG_LEVEL_DBG=y
CONFIG_NRF_CLOUD_WIFI_SAMPLE_LOG_LEVEL_DBG=y

# for ESP32, just hard code the client ID -- CHANGE ME FOR EACH NEW UNIT
CONFIG_NRF_CLOUD_CLIENT_ID="wifi-12345"
CONFIG_NRF_CLOUD_CLIENT_ID_SRC_COMPILE_TIME=y
```

## src/main.c
```c
/*
 * Copyright (c) 2020 Espressif Systems (Shanghai) Co., Ltd.
 *
 * SPDX-License-Identifier: Apache-2.0
 */

#include <zephyr.h>
#include <sys/printk.h>
#include <esp_wifi.h>
#include <esp_timer.h>
#include <esp_event.h>

#include <net/net_if.h>
#include <net/net_core.h>
#include <net/net_context.h>
#include <net/net_mgmt.h>

#include <mbedtls/ssl_ciphersuites.h>

#include <net/nrf_cloud.h>

#include <cJSON.h>
#include <cJSON_os.h>

#include <logging/log.h>

#include "libc_support.h"

LOG_MODULE_REGISTER(esp32_wifi_sta, CONFIG_NRF_CLOUD_WIFI_SAMPLE_LOG_LEVEL);

#define SEC_TAG CONFIG_NRF_CLOUD_SEC_TAG
#define TEMP_ID "TEMP"
#define HUMID_ID "HUMID"

static K_SEM_DEFINE(wifi_connected, 0, 1);
static K_SEM_DEFINE(cloud_connected, 0, 1);
static K_SEM_DEFINE(cloud_ready, 0, 1);

static struct net_mgmt_event_callback dhcp_cb;

/**
 * @brief Handle network management events.
 *
 * @param cb - Original handler that called us
 * @param mgmt_event - The network event being notified.
 * @param iface - The network interface generating the event.
 */
static void handler_cb(struct net_mgmt_event_callback *cb,
		    uint32_t mgmt_event, struct net_if *iface)
{
	if (mgmt_event != NET_EVENT_IPV4_DHCP_BOUND) {
		LOG_WRN("Received mgmt_event:%u", mgmt_event);
		return;
	}

	char buf[NET_IPV4_ADDR_LEN];

	LOG_INF("Your address: %s",
		log_strdup(net_addr_ntop(AF_INET,
				   &iface->config.dhcpv4.requested_ip,
				   buf, sizeof(buf))));
	LOG_INF("Lease time: %u seconds",
			iface->config.dhcpv4.lease_time);
	LOG_INF("Subnet: %s",
		log_strdup(net_addr_ntop(AF_INET,
					&iface->config.ip.ipv4->netmask,
					buf, sizeof(buf))));
	LOG_INF("Router: %s",
		log_strdup(net_addr_ntop(AF_INET,
						&iface->config.ip.ipv4->gw,
						buf, sizeof(buf))));
	k_sem_give(&wifi_connected);
}

/**
 * @brief Handle nrfcloud events.
 *
 * @param evt - the event that occurred.
 */
static void cloud_handler(const struct nrf_cloud_evt *evt)
{
	switch (evt->type) {
	case NRF_CLOUD_EVT_TRANSPORT_CONNECTING:
		LOG_INF("NRF_CLOUD_EVT_TRANSPORT_CONNECTING: %d", evt->status);
		break;
	case NRF_CLOUD_EVT_TRANSPORT_CONNECTED:
		LOG_INF("NRF_CLOUD_EVT_TRANSPORT_CONNECTED: %d", evt->status);
		k_sem_give(&cloud_connected);
		break;
	case NRF_CLOUD_EVT_USER_ASSOCIATION_REQUEST:
		LOG_INF("NRF_CLOUD_EVT_USER_ASSOCIATION_REQUEST: %d", evt->status);
		break;
	case NRF_CLOUD_EVT_USER_ASSOCIATED:
		LOG_INF("NRF_CLOUD_EVT_USER_ASSOCIATED: %d", evt->status);
		break;
	case NRF_CLOUD_EVT_READY:
		/* we can now send data to cloud */
		LOG_INF("NRF_CLOUD_EVT_READY: %d", evt->status);
		k_sem_give(&cloud_ready);
		break;
	case NRF_CLOUD_EVT_RX_DATA:
		LOG_INF("NRF_CLOUD_EVT_RX_DATA: %d", evt->status);
		LOG_INF("  Data received on topic len: %d: %s",
			evt->topic.len, log_strdup(evt->topic.ptr));
		LOG_INF("  Data len: %d: %s",
			evt->data.len, log_strdup(evt->data.ptr));
		break;
	case NRF_CLOUD_EVT_SENSOR_DATA_ACK:
		LOG_INF("NRF_CLOUD_EVT_SENSOR_DATA_ACK: %d", evt->status);
		break;
	case NRF_CLOUD_EVT_TRANSPORT_DISCONNECTED:
		LOG_INF("NRF_CLOUD_EVT_TRANSPORT_DISCONNECTED: %d", evt->status);
		break;
	case NRF_CLOUD_EVT_FOTA_DONE:
		LOG_INF("NRF_CLOUD_EVT_FOTA_DONE: %d", evt->status);
		break;
	case NRF_CLOUD_EVT_ERROR:
		LOG_ERR("NRF_CLOUD_EVT_ERROR: %d", evt->status);
		break;
	case NRF_CLOUD_EVT_FOTA_START:
		LOG_INF("NRF_CLOUD_EVT_FOTA_START: %d", evt->status);
		break;
	case NRF_CLOUD_EVT_FOTA_ERROR:
		LOG_ERR("NRF_CLOUD_FOTA_ERROR: %d", evt->status);
		break;
	}
}

/**
 * define static arrays containing our credentials; in the future, these
 * should be stored in secure storage
 */
#if defined(MBEDTLS_X509_CRT_PARSE_C)

static const unsigned char ca_certificate[] = {
	#include "ca_cert.h"
};

static const unsigned char client_certificate[] = {
	#include "client_cert.h"
};

static const unsigned char private_key[] = {
	#include "private_key.h"
};

#endif

/**
 * @brief load CA, client cert, and private key to specified security tag
 * in the TLS stack.
 *
 * @param sec_tag the tag to load credentials into.
 * @return 0 on success or negative error code on failure.
 */
static int tls_load_credentials(int sec_tag)
{
	int ret;

	/* Load CA certificate */
	ret = tls_credential_add(sec_tag, TLS_CREDENTIAL_CA_CERTIFICATE,
				ca_certificate, sizeof(ca_certificate));
	if (ret != 0) {
		LOG_ERR("Failed to register CA certificate: %d", ret);
		goto exit;
	}

	/* Load server/client certificate */
	ret = tls_credential_add(sec_tag,
				TLS_CREDENTIAL_SERVER_CERTIFICATE,
				client_certificate, sizeof(client_certificate));
	if (ret < 0) {
		LOG_ERR("Failed to register public cert: %d", ret);
		goto exit;
	}

	/* Load private key */
	ret = tls_credential_add(sec_tag, TLS_CREDENTIAL_PRIVATE_KEY,
				private_key, sizeof(private_key));
	if (ret < 0) {
		LOG_ERR("Failed to register private key: %d", ret);
		goto exit;
	}

exit:
	return ret;
}

/**
 * @brief Free up resources from specified security tag.
 *
 * @param sec_tag - the tag to free.
 * @return 0 on success.
 */
static int tls_unloadcrdl(int sec_tag)
{
	tls_credential_delete(sec_tag, TLS_CREDENTIAL_CA_CERTIFICATE);
	tls_credential_delete(sec_tag, TLS_CREDENTIAL_SERVER_CERTIFICATE);
	tls_credential_delete(sec_tag, TLS_CREDENTIAL_PRIVATE_KEY);

	return 0;
}

/**
 * @brief Update device shadow to indicate the services this device supports.
 *
 * @return 0 on success or negative error code if failed.
 */
static int send_service_info(void)
{
	struct nrf_cloud_svc_info_fota fota_info = {
		.application = false,
		.bootloader = false,
		.modem = false
	};
	struct nrf_cloud_svc_info_ui ui_info = {
		.gps = false,
		.humidity = true,
		.rsrp = false,
		.temperature = true,
		.button = false
	};
	struct nrf_cloud_svc_info service_info = {
		.fota = &fota_info,
		.ui = &ui_info
	};
	struct nrf_cloud_device_status device_status = {
		.modem = NULL,
		.svc = &service_info

	};

	return nrf_cloud_shadow_device_status_update(&device_status);
}

/* accumulate random values in the range of +/- scale */
void simulate_sensor_data(float *sensor_value, float scale)
{
	*sensor_value += (rand() - RAND_MAX / 2) * scale / (RAND_MAX / 2);
}

/* on ESP32, we have to use the Zephyr minimal libc instead of
 * newlib due to a known incompatibility, so we don't get
 * floating point printf(); fake it for now
 */
void render_sensor_data(char *output, size_t len, const char *id, float sensor_value)
{
	/* printf formatter for JSON message to send containing fake temperature data */
	static const char data_fmt[] = "{\"appId\":\"%s\", \"messageType\":\"DATA\","
				       " \"data\":\"%d.%d\"}";

	snprintf(output, len, data_fmt, id, (int)sensor_value,
		 ((int)(sensor_value * 10)) % 10);
}

void main(void)
{
	struct net_if *iface;
	int err;
	esp_err_t ret;

	LOG_INF("nRF Cloud WiFi demo starting up...");

	err = tls_load_credentials(SEC_TAG);
	if (err) {
		LOG_ERR("Unable to load credentials: %d", err);
	}

	net_mgmt_init_event_callback(&dhcp_cb, handler_cb,
				     NET_EVENT_IPV4_DHCP_BOUND);

	net_mgmt_add_event_callback(&dhcp_cb);

	iface = net_if_get_default();
	if (!iface) {
		LOG_ERR("wifi interface not available");
		return;
	}

	net_dhcpv4_start(iface);

	if (!IS_ENABLED(CONFIG_ESP32_WIFI_STA_AUTO)) {
		wifi_config_t wifi_config = {
			.sta = {
				.ssid = CONFIG_ESP32_WIFI_SSID,
				.password = CONFIG_ESP32_WIFI_PASSWORD,
			},
		};

		ret = esp_wifi_set_mode(WIFI_MODE_STA);

		ret |= esp_wifi_set_config(ESP_IF_WIFI_STA, &wifi_config);
		ret |= esp_wifi_connect();
		if (ret != ESP_OK) {
			LOG_ERR("Connection failed: %d", ret);
		}
	}
	LOG_INF("Waiting for WiFi connection...");
	k_sem_take(&wifi_connected, K_FOREVER);

	uint8_t mac[6];

	ret |= esp_wifi_get_mac(WIFI_IF_STA, mac);
	if (ret != ESP_OK) {
		LOG_ERR("Could not get WiFi MAC: %d", ret);
	} else {
		LOG_INF("WiFi MAC: %02X:%02X:%02X:%02X:%02X:%02X",
			mac[0], mac[1], mac[2], mac[3], mac[4], mac[5]);
	}

#if defined(TEST_LIBC)
	test_libc();
#endif

	/* connect to nRF Cloud */
	struct nrf_cloud_init_param init_param = {
		.event_handler = cloud_handler,
		.client_id = NULL
	};

	LOG_INF("Initializing nRF Cloud...");
	err = nrf_cloud_init(&init_param);
	if (err) {
		LOG_ERR("Error initializing nRF Cloud: %d", err);
		return;
	}

	/* look up our configured device id */
	char client_id[NRF_CLOUD_CLIENT_ID_MAX_LEN];

	err = nrf_cloud_client_id_get(client_id, sizeof(client_id));
	if (err) {
		LOG_ERR("Error getting client id: %d", err);
	} else {
		LOG_INF("Client id: %s", log_strdup(client_id));
	}

	LOG_INF("Connecting to nRF Cloud...");
	err = nrf_cloud_connect(NULL);
	if (err) {
		LOG_ERR("Error connecting to nRF Cloud: %d", err);
		return;
	}

	LOG_INF("Waiting for Cloud connection to be ready...");
	k_sem_take(&cloud_ready, K_FOREVER);

	char tenant_id[NRF_CLOUD_TENANT_ID_MAX_LEN];

	err = nrf_cloud_tenant_id_get(tenant_id, sizeof(tenant_id));
	if (err) {
		LOG_ERR("Error getting tenant id: %d", err);
	} else {
		LOG_INF("Tenant id: %s", log_strdup(tenant_id));
	}

	err = send_service_info();
	if (err) {
		LOG_ERR("Error sending service info: %d", err);
	} else {
		LOG_INF("Service info sent.");
	}

	char data[100];
	struct nrf_cloud_tx_data msg = {
		.topic_type = NRF_CLOUD_TOPIC_MESSAGE,
		.qos = MQTT_QOS_1_AT_LEAST_ONCE,
		.data.ptr = data
	};
	float temp = 10.0;
	float humid = 25.0;

	do
	{
		simulate_sensor_data(&temp, 0.5f);
		render_sensor_data(data, sizeof(data), TEMP_ID, temp);
		msg.data.len = strlen(data);

		LOG_INF("Sending %s to nRF Cloud...", log_strdup(data));

		err = nrf_cloud_send(&msg);
		if (!err) {
			simulate_sensor_data(&humid, 0.1f);
			render_sensor_data(data, sizeof(data), HUMID_ID, humid);
			msg.data.len = strlen(data);

			LOG_INF("Sending %s to nRF Cloud...", log_strdup(data));

			err = nrf_cloud_send(&msg);
		}
		if (err) {
			LOG_ERR("Error sending message to cloud: %d", err);
			k_sleep(K_SECONDS(1));

			k_sem_reset(&cloud_ready);
			LOG_INF("Reconnecting to nRF Cloud...");
			err = nrf_cloud_connect(NULL);
			if (err) {
				LOG_ERR("Connection failed: %d", err);
				break;
			}
			k_sem_take(&cloud_ready, K_FOREVER);
			LOG_INF("Connected.");
		} else {
			LOG_INF("message sent!");
		}

		k_sleep(K_SECONDS(5));
	} while (1);

	err = nrf_cloud_disconnect();
	if (err) {
		LOG_ERR("Error disconnecting from nRF Cloud: %d", err);
	} else {
		LOG_INF("Disconnected.");
	}

	tls_unloadcrdl(SEC_TAG);
}
```

## src/atob.c
```c
/* $Id: atob.c,v 1.5 2003/10/08 16:45:18 pefo Exp $ */

/*
 * Copyright (c) 2000-2002 Opsycon AB  (www.opsycon.se)
 * 
 * Redistribution and use in source and binary forms, with or without
 * modification, are permitted provided that the following conditions
 * are met:
 * 1. Redistributions of source code must retain the above copyright
 *    notice, this list of conditions and the following disclaimer.
 * 2. Redistributions in binary form must reproduce the above copyright
 *    notice, this list of conditions and the following disclaimer in the
 *    documentation and/or other materials provided with the distribution.
 * 3. All advertising materials mentioning features or use of this software
 *    must display the following acknowledgement:
 *	This product includes software developed by Opsycon AB.
 * 4. The name of the author may not be used to endorse or promote products
 *    derived from this software without specific prior written permission.
 *
 * THIS SOFTWARE IS PROVIDED BY THE AUTHOR ``AS IS'' AND ANY EXPRESS
 * OR IMPLIED WARRANTIES, INCLUDING, BUT NOT LIMITED TO, THE IMPLIED
 * WARRANTIES OF MERCHANTABILITY AND FITNESS FOR A PARTICULAR PURPOSE
 * ARE DISCLAIMED.  IN NO EVENT SHALL THE AUTHOR BE LIABLE FOR ANY
 * DIRECT, INDIRECT, INCIDENTAL, SPECIAL, EXEMPLARY, OR CONSEQUENTIAL
 * DAMAGES (INCLUDING, BUT NOT LIMITED TO, PROCUREMENT OF SUBSTITUTE GOODS
 * OR SERVICES; LOSS OF USE, DATA, OR PROFITS; OR BUSINESS INTERRUPTION)
 * HOWEVER CAUSED AND ON ANY THEORY OF LIABILITY, WHETHER IN CONTRACT, STRICT
 * LIABILITY, OR TORT (INCLUDING NEGLIGENCE OR OTHERWISE) ARISING IN ANY WAY
 * OUT OF THE USE OF THIS SOFTWARE, EVEN IF ADVISED OF THE POSSIBILITY OF
 * SUCH DAMAGE.
 *
 */

#include <sys/types.h>
#include <string.h>
//#include <pmon.h>

#include <stdint.h>
#define u_int32_t uint32_t
#define u_long unsigned long
#define u_int unsigned int

#define __P(x) x

static char * _getbase __P((char *, int *));
#ifdef HAVE_QUAD
static int _atob __P((unsigned long long *, char *p, int));
#else
static int _atob __P((unsigned long  *, char *, int));
#endif

static char *
_getbase(char *p, int *basep)
{
	if (p[0] == '0') {
		switch (p[1]) {
		case 'x':
			*basep = 16;
			break;
		case 't': case 'n':
			*basep = 10;
			break;
		case 'o':
			*basep = 8;
			break;
		default:
			*basep = 10;
			return (p);
		}
		return (p + 2);
	}
	*basep = 10;
	return (p);
}


/*
 *  _atob(vp,p,base)
 */
static int
#ifdef HAVE_QUAD
_atob (u_quad_t *vp, char *p, int base)
{
	u_quad_t value, v1, v2;
#else
_atob (unsigned long *vp, char *p, int base)
{
	u_long value, v1, v2;
#endif
	char *q, tmp[20];
	int digit;

	if (p[0] == '0' && (p[1] == 'x' || p[1] == 'X')) {
		base = 16;
		p += 2;
	}

	if (base == 16 && (q = strchr (p, '.')) != 0) {
		if (q - p > sizeof(tmp) - 1)
			return (0);

		strncpy (tmp, p, q - p);
		tmp[q - p] = '\0';
		if (!_atob (&v1, tmp, 16))
			return (0);

		q++;
		if (strchr (q, '.'))
			return (0);

		if (!_atob (&v2, q, 16))
			return (0);
		*vp = (v1 << 16) + v2;
		return (1);
	}

	value = *vp = 0;
	for (; *p; p++) {
		if (*p >= '0' && *p <= '9')
			digit = *p - '0';
		else if (*p >= 'a' && *p <= 'f')
			digit = *p - 'a' + 10;
		else if (*p >= 'A' && *p <= 'F')
			digit = *p - 'A' + 10;
		else
			return (0);

		if (digit >= base)
			return (0);
		value *= base;
		value += digit;
	}
	*vp = value;
	return (1);
}

/*
 *  atob(vp,p,base) 
 *      converts p to binary result in vp, rtn 1 on success
 */
int
atob(u_int32_t *vp, char *p, int base)
{
#ifdef HAVE_QUAD
	u_quad_t v;
#else
	u_long  v;
#endif

	if (base == 0)
		p = _getbase (p, &base);
	if (_atob (&v, p, base)) {
		*vp = v;
		return (1);
	}
	return (0);
}


#ifdef HAVE_QUAD
/*
 *  llatob(vp,p,base) 
 *      converts p to binary result in vp, rtn 1 on success
 */
int
llatob(u_quad_t *vp, char *p, int base)
{
	if (base == 0)
		p = _getbase (p, &base);
	return _atob(vp, p, base);
}
#endif


/*
 *  char *btoa(dst,value,base) 
 *      converts value to ascii, result in dst
 */
char *
btoa(char *dst, u_int value, int base)
{
	char buf[34], digit;
	int i, j, rem, neg;

	if (value == 0) {
		dst[0] = '0';
		dst[1] = 0;
		return (dst);
	}

	neg = 0;
	if (base == -10) {
		base = 10;
		if (value & (1L << 31)) {
			value = (~value) + 1;
			neg = 1;
		}
	}

	for (i = 0; value != 0; i++) {
		rem = value % base;
		value /= base;
		if (rem >= 0 && rem <= 9)
			digit = rem + '0';
		else if (rem >= 10 && rem <= 36)
			digit = (rem - 10) + 'a';
		else
			digit = 0;
		buf[i] = digit;
	}

	buf[i] = 0;
	if (neg)
		strcat (buf, "-");

	/* reverse the string */
	for (i = 0, j = strlen (buf) - 1; j >= 0; i++, j--)
		dst[i] = buf[j];
	dst[i] = 0;
	return (dst);
}

#ifdef HAVE_QUAD
/*
 *  char *btoa(dst,value,base) 
 *      converts value to ascii, result in dst
 */
char *
llbtoa(char *dst, u_quad_t value, int base)
{
	char buf[66], digit;
	int i, j, rem, neg;

	if (value == 0) {
		dst[0] = '0';
		dst[1] = 0;
		return (dst);
	}

	neg = 0;
	if (base == -10) {
		base = 10;
		if (value & (1LL << 63)) {
			value = (~value) + 1;
			neg = 1;
		}
	}

	for (i = 0; value != 0; i++) {
		rem = value % base;
		value /= base;
		if (rem >= 0 && rem <= 9)
			digit = rem + '0';
		else if (rem >= 10 && rem <= 36)
			digit = (rem - 10) + 'a';
		buf[i] = digit;
	}

	buf[i] = 0;
	if (neg)
		strcat (buf, "-");

	/* reverse the string */
	for (i = 0, j = strlen (buf) - 1; j >= 0; i++, j--)
		dst[i] = buf[j];
	dst[i] = 0;
	return (dst);
}
#endif

/*
 *  gethex(vp,p,n) 
 *      convert n hex digits from p to binary, result in vp, 
 *      rtn 1 on success
 */
int
gethex(int32_t *vp, char *p, int n)
{
	u_long v;
	int digit;

	for (v = 0; n > 0; n--) {
		if (*p == 0)
			return (0);
		if (*p >= '0' && *p <= '9')
			digit = *p - '0';
		else if (*p >= 'a' && *p <= 'f')
			digit = *p - 'a' + 10;
		else if (*p >= 'A' && *p <= 'F')
			digit = *p - 'A' + 10;
		else
			return (0);

		v <<= 4;
		v |= digit;
		p++;
	}
	*vp = v;
	return (1);
}
```

## src/libc_support.c
```c
#include <zephyr.h>
#include <cJSON.h>
#include <cJSON_os.h>
#include <random/rand32.h>

#include <logging/log.h>

#include "libc_support.h"

LOG_MODULE_DECLARE(esp32_wifi_sta, CONFIG_NRF_CLOUD_WIFI_SAMPLE_LOG_LEVEL);

#if defined(CONFIG_SOC_ESP32)

double fabs(double x)
{
	return x < 0 ? -x : x;
}

#if defined(CONFIG_EXTERNAL_LIBC)

int _close_r(void *r, int fd)
{
	return close(fd);
}

int _fstat_r(void *r, int fd, void *sbuf)
{
	return fstat(fd, sbuf);
}

_off_t _lseek_r(void *r, int fd, _off_t size, int m)
{
	return lseek(fd, size, m);
}

int _read_r(void *r, int fd, char *buf, size_t len)
{
	return read(fd, buf, len);
}

int _write_r(void *r, int fd, char *buf, size_t len)
{
	return write(fd, buf, len);
}

static int _stdout_hook_default(int c)
{
	(void)(c);  /* Prevent warning about unused argument */
	return EOF;
}

static int (*_stdout_hook)(int) = _stdout_hook_default;

void __stdout_hook_install(int (*hook)(int val))
{
	_stdout_hook = hook;
}

int pthread_setcancelstate(int state, int *oldstate)
{
	return -1;
}

struct _reent * __getreent(void)
{
	return NULL;
}

int _getpid_r(void *r)
{
	return getpid();
}

int _kill_r(void *r, int pid, int sig)
{
	return kill(pid, sig);
}

int end(void)
{
	return 0;
}
#else
int rand(void)
{
	return (int)sys_rand32_get() / (0xffffffff / (RAND_MAX - 1));
}

#endif /* CONFIG_EXTERNAL_LIBC */
#endif

#if defined(TEST_LIBC)
void test_libc(void)
{
	char *test_strtod = "3.14159";
	char *test_sscanf = "apple 12 47.5";
	char *test_json = "{\"appId\": \"HUMID\", \"messageType\": \"DATA\",\"data\": \"70.0\"}";
	float value;
	char tmp[100];
	int err;
	char *null_ptr;
	int num;

	LOG_INF("**************");
	value = strtod(test_strtod, &null_ptr);
	LOG_INF("strtod(%s) returned: %d.%03d", log_strdup(test_strtod),
		(int)value, (int)((value - (int)value) * 1000.0));

	memset(tmp, 0, sizeof(tmp));
	value = 0;
	num = 0;
	err = sscanf(test_sscanf, "%s %d %g", tmp, &num, &value);
	LOG_INF("sscanf() returned %d; string: %s, int:%d, double:%d.%03d",
		err, log_strdup(tmp), num, (int)value, (int)((value - (int)value) * 1000.0));

	LOG_INF("Parsing %s...", log_strdup(test_json));
	cJSON *root = cJSON_Parse(test_json);
	if (root) {
		char *out = cJSON_Print(root);
		if (out) {
			LOG_INF("Result: %s", log_strdup(out));
			/* crashes: cJSON_FreeString(out); */
		}
		cJSON *data_obj = cJSON_GetObjectItem(root, "data");
		if (data_obj) {
			char *out = cJSON_Print(data_obj);
			if (out) {
				LOG_INF("Data str: %s", log_strdup(out));
			}
			if (cJSON_IsNumber(data_obj)) {
				double data = cJSON_GetNumberValue(data_obj);
				LOG_INF("data: %d.%03d", 
					(int)data, (int)((data - (int)data) * 1000.0));
			}
		}

		LOG_INF("deleting object...");
		cJSON_Delete(root);
	}
	LOG_INF("**************");
}
#endif
```

## src/libc_support.h
```c
#ifndef _LIBC_SUPPORT_H_
#define _LIBC_SUPPORT_H_

#define TEST_LIBC

#if defined(CONFIG_SOC_ESP32)
double fabs(double x);

#if defined(CONFIG_EXTERNAL_LIBC)
int close(int fd);
int _close_r(void *r, int fd);

int fstat(int fd, void *sbuf);
int _fstat_r(void *r, int fd, void *sbuf);

_off_t lseek(int fd, _off_t size, int m);
_off_t _lseek_r(void *r, int fd, _off_t size, int m);

int read(int fd, char *buf, size_t len);
int _read_r(void *r, int fd, char *buf, size_t len);

int write(int fd, char *buf, size_t len);
int _write_r(void *r, int fd, char *buf, size_t len);

static int _stdout_hook_default(int c);
void __stdout_hook_install(int (*hook)(int val));

int pthread_setcancelstate(int state, int *oldstate);

struct _reent * __getreent(void);

int getpid(void);
int _getpid_r(void *r);

int kill(int pid, int sig);
int _kill_r(void *r, int pid, int sig);

int end(void);

#else
#define RAND_MAX 32768
int rand(void);
#endif
#endif

#if defined(TEST_LIBC)
void test_libc(void);
#endif

#endif
```

## src/scanf.c
```c
/* $Id: scanf.c,v 1.2 2002/08/09 20:56:57 pefo Exp $ */

/*
 * Copyright (c) 2000-2002 Opsycon AB  (www.opsycon.se)
 * 
 * Redistribution and use in source and binary forms, with or without
 * modification, are permitted provided that the following conditions
 * are met:
 * 1. Redistributions of source code must retain the above copyright
 *    notice, this list of conditions and the following disclaimer.
 * 2. Redistributions in binary form must reproduce the above copyright
 *    notice, this list of conditions and the following disclaimer in the
 *    documentation and/or other materials provided with the distribution.
 * 3. All advertising materials mentioning features or use of this software
 *    must display the following acknowledgement:
 *	This product includes software developed by Opsycon AB.
 * 4. The name of the author may not be used to endorse or promote products
 *    derived from this software without specific prior written permission.
 *
 * THIS SOFTWARE IS PROVIDED BY THE AUTHOR ``AS IS'' AND ANY EXPRESS
 * OR IMPLIED WARRANTIES, INCLUDING, BUT NOT LIMITED TO, THE IMPLIED
 * WARRANTIES OF MERCHANTABILITY AND FITNESS FOR A PARTICULAR PURPOSE
 * ARE DISCLAIMED.  IN NO EVENT SHALL THE AUTHOR BE LIABLE FOR ANY
 * DIRECT, INDIRECT, INCIDENTAL, SPECIAL, EXEMPLARY, OR CONSEQUENTIAL
 * DAMAGES (INCLUDING, BUT NOT LIMITED TO, PROCUREMENT OF SUBSTITUTE GOODS
 * OR SERVICES; LOSS OF USE, DATA, OR PROFITS; OR BUSINESS INTERRUPTION)
 * HOWEVER CAUSED AND ON ANY THEORY OF LIABILITY, WHETHER IN CONTRACT, STRICT
 * LIABILITY, OR TORT (INCLUDING NEGLIGENCE OR OTHERWISE) ARISING IN ANY WAY
 * OUT OF THE USE OF THIS SOFTWARE, EVEN IF ADVISED OF THE POSSIBILITY OF
 * SUCH DAMAGE.
 *
 */
#include <stdio.h>
#include <stdarg.h>
#include <string.h>
#include <ctype.h>

//#include <pmon.h>
#define MAXLN 1024
#include <stdint.h>
#define u_int32_t uint32_t

/*
 * ** fscanf --\    sscanf --\
 * **          |                  |
 * **  scanf --+-- vfscanf ----- vsscanf
 * **
 * ** This not been very well tested.. it probably has bugs
 */
//static int vfscanf __P((FILE *, const char *, va_list));
//static int vsscanf __P((const char *, const char *, va_list));
static int vsscanf (const char *buf, const char *s, va_list ap);
int atob(u_int32_t *vp, char *p, int base);
double strtod(const char *string, char **endPtr);

#define ISSPACE " \t\n\r\f\v"

/*
 *  scanf(fmt,va_alist) 
 */
#if 0
int 
scanf (const char *fmt, ...)
{
    int             count;
    va_list ap;
    
    va_start (ap, fmt);
    count = vfscanf (stdin, fmt, ap);
    va_end (ap);
    return (count);
}
#endif

/*
 *  fscanf(fp,fmt,va_alist)
 */
#if 0
int 
fscanf (FILE *fp, const char *fmt, ...)
{
    int             count;
    va_list ap;

    va_start (ap, fmt);
    count = vfscanf (fp, fmt, ap);
    va_end (ap);
    return (count);
}
#endif

/*
 *  sscanf(buf,fmt,va_alist)
 */
int 
sscanf (const char *buf, const char *fmt, ...)
{
    int             count;
    va_list ap;
    
    va_start (ap, fmt);
    count = vsscanf (buf, fmt, ap);
    va_end (ap);
    return (count);
}

/*
 *  vfscanf(fp,fmt,ap) 
 */
#if 0
static int
vfscanf (FILE *fp, const char *fmt, va_list ap)
{
    int             count;
    char            buf[MAXLN + 1];

    if (fgets (buf, MAXLN, fp) == 0)
	return (-1);
    count = vsscanf (buf, fmt, ap);
    return (count);
}
#endif

/*
 *  vsscanf(buf,fmt,ap)
 */
static int
vsscanf (const char *buf, const char *s, va_list ap)
{
    int             count, noassign, width, base, lflag;
    const char     *tc;
    char           *t, tmp[MAXLN];

    base = 10;
    count = noassign = width = lflag = 0;
    while (*s && *buf) {
	while (isspace (*s))
	    s++;
	if (*s == '%') {
	    s++;
	    for (; *s; s++) {
		if (strchr ("dibouxcsefg%", *s))
		    break;
		if (*s == '*')
		    noassign = 1;
		else if (*s == 'l' || *s == 'L')
		    lflag = 1;
		else if (*s >= '1' && *s <= '9') {
		    for (tc = s; isdigit (*s); s++);
		    strncpy (tmp, tc, s - tc);
		    tmp[s - tc] = '\0';
		    atob (&width, tmp, 10);
		    s--;
		}
	    }
	    if (*s == 's') {
		while (isspace (*buf))
		    buf++;
		if (!width)
		    width = strcspn (buf, ISSPACE);
		if (!noassign) {
		    strncpy (t = va_arg (ap, char *), buf, width);
		    t[width] = '\0';
		}
		buf += width;
	    } else if (*s == 'c') {
		if (!width)
		    width = 1;
		if (!noassign) {
		    strncpy (t = va_arg (ap, char *), buf, width);
		    t[width] = '\0';
		}
		buf += width;
	    } else if (strchr ("dobxu", *s)) {
		while (isspace (*buf))
		    buf++;
		if (*s == 'd' || *s == 'u')
		    base = 10;
		else if (*s == 'x')
		    base = 16;
		else if (*s == 'o')
		    base = 8;
		else if (*s == 'b')
		    base = 2;
		if (!width) {
		    if (isspace (*(s + 1)) || *(s + 1) == 0)
			width = strcspn (buf, ISSPACE);
		    else
			width = strchr (buf, *(s + 1)) - buf;
		}
		strncpy (tmp, buf, width);
		tmp[width] = '\0';
		buf += width;
		if (!noassign)
		    atob (va_arg (ap, u_int32_t *), tmp, base);
	    } else if (strchr ("fg", *s)) {
		    while (isspace (*buf))
			buf++;
		    if (!width) {
			if (isspace (*(s + 1)) || *(s + 1) == 0)
			    width = strcspn (buf, ISSPACE);
			else
			    width = strchr (buf, *(s + 1)) - buf;
		    }
		    strncpy (tmp, buf, width);
		    tmp[width] = '\0';
		    buf += width;
		    if (!noassign) {
			*va_arg(ap, double *) = strtod(tmp, NULL);
		    }
	    }
	    if (!noassign)
		count++;
	    width = noassign = lflag = 0;
	    s++;
	} else {
	    while (isspace (*buf))
		buf++;
	    if (*s != *buf)
		break;
	    else
		s++, buf++;
	}
    }
    return (count);
}
```

## src/strtod.c
```c
/*
 * strtod.c --
 *
 *	Source code for the "strtod" library procedure.
 *
 * Copyright (c) 1988-1993 The Regents of the University of California.
 * Copyright (c) 1994 Sun Microsystems, Inc.
 *
 * Permission to use, copy, modify, and distribute this
 * software and its documentation for any purpose and without
 * fee is hereby granted, provided that the above copyright
 * notice appear in all copies.  The University of California
 * makes no representations about the suitability of this
 * software for any purpose.  It is provided "as is" without
 * express or implied warranty.
 *
 * RCS: @(#) $Id$
 *
 * Taken from http://svn.ruby-lang.org/repos/ruby/branches/ruby_1_8/missing/strtod.c
 */
#include <stdlib.h>
#include <ctype.h>
#include <errno.h>

//#include <locale.h>
#define locale_t int

extern  int     errno;
#ifndef __STDC__
# ifdef __GNUC__
#  define const __const__
# else
#  define const
# endif
#endif
#ifndef TRUE
#define TRUE 1
#define FALSE 0
#endif
#ifndef NULL
#define NULL 0
#endif
static int maxExponent = 511;	/* Largest possible base 10 exponent.  Any
				 * exponent larger than this will already
				 * produce underflow or overflow, so there's
				 * no need to worry about additional digits.
				 */
static double powersOf10[] = {	/* Table giving binary powers of 10.  Entry */
    10.,			/* is 10^2^i.  Used to convert decimal */
    100.,			/* exponents into floating-point numbers. */
    1.0e4,
    1.0e8,
    1.0e16,
    1.0e32,
    1.0e64,
    1.0e128,
    1.0e256
};

/*
 *----------------------------------------------------------------------
 *
 * strtod --
 *
 *	This procedure converts a floating-point number from an ASCII
 *	decimal representation to internal double-precision format.
 *
 * Results:
 *	The return value is the double-precision floating-point
 *	representation of the characters in string.  If endPtr isn't
 *	NULL, then *endPtr is filled in with the address of the
 *	next character after the last one that was part of the
 *	floating-point number.
 *
 * Side effects:
 *	None.
 *
 *----------------------------------------------------------------------
 */
double
strtod(string, endPtr)
    const char *string;		/* A decimal ASCII floating-point number,
				 * optionally preceded by white space.
				 * Must have form "-I.FE-X", where I is the
				 * integer part of the mantissa, F is the
				 * fractional part of the mantissa, and X
				 * is the exponent.  Either of the signs
				 * may be "+", "-", or omitted.  Either I
				 * or F may be omitted, or both.  The decimal
				 * point isn't necessary unless F is present.
				 * The "E" may actually be an "e".  E and X
				 * may both be omitted (but not just one).
				 */
    char **endPtr;		/* If non-NULL, store terminating character's
				 * address here. */
{
    int sign, expSign = FALSE;
    double fraction, dblExp, *d;
    register const char *p;
    register int c;
    int exp = 0;		/* Exponent read from "EX" field. */
    int fracExp = 0;		/* Exponent that derives from the fractional
				 * part.  Under normal circumstatnces, it is
				 * the negative of the number of digits in F.
				 * However, if I is very long, the last digits
				 * of I get dropped (otherwise a long I with a
				 * large negative exponent could cause an
				 * unnecessary overflow on I alone).  In this
				 * case, fracExp is incremented one for each
				 * dropped digit. */
    int mantSize;		/* Number of digits in mantissa. */
    int decPt;			/* Number of mantissa digits BEFORE decimal
				 * point. */
    const char *pExp;		/* Temporarily holds location of exponent
				 * in string. */
    /*
     * Strip off leading blanks and check for a sign.
     */
    p = string;
    while (isspace(*p)) {
	p += 1;
    }
    if (*p == '-') {
	sign = TRUE;
	p += 1;
    } else {
	if (*p == '+') {
	    p += 1;
	}
	sign = FALSE;
    }
    /*
     * Count the number of digits in the mantissa (including the decimal
     * point), and also locate the decimal point.
     */
    decPt = -1;
    for (mantSize = 0; ; mantSize += 1)
    {
	c = *p;
	if (!isdigit(c)) {
	    if ((c != '.') || (decPt >= 0)) {
		break;
	    }
	    decPt = mantSize;
	}
	p += 1;
    }
    /*
     * Now suck up the digits in the mantissa.  Use two integers to
     * collect 9 digits each (this is faster than using floating-point).
     * If the mantissa has more than 18 digits, ignore the extras, since
     * they can't affect the value anyway.
     */
    
    pExp  = p;
    p -= mantSize;
    if (decPt < 0) {
	decPt = mantSize;
    } else {
	mantSize -= 1;			/* One of the digits was the point. */
    }
    if (mantSize > 18) {
	fracExp = decPt - 18;
	mantSize = 18;
    } else {
	fracExp = decPt - mantSize;
    }
    if (mantSize == 0) {
	fraction = 0.0;
	p = string;
	goto done;
    } else {
	int frac1, frac2;
	frac1 = 0;
	for ( ; mantSize > 9; mantSize -= 1)
	{
	    c = *p;
	    p += 1;
	    if (c == '.') {
		c = *p;
		p += 1;
	    }
	    frac1 = 10*frac1 + (c - '0');
	}
	frac2 = 0;
	for (; mantSize > 0; mantSize -= 1)
	{
	    c = *p;
	    p += 1;
	    if (c == '.') {
		c = *p;
		p += 1;
	    }
	    frac2 = 10*frac2 + (c - '0');
	}
	fraction = (1.0e9 * frac1) + frac2;
    }
    /*
     * Skim off the exponent.
     */
    p = pExp;
    if ((*p == 'E') || (*p == 'e')) {
	p += 1;
	if (*p == '-') {
	    expSign = TRUE;
	    p += 1;
	} else {
	    if (*p == '+') {
		p += 1;
	    }
	    expSign = FALSE;
	}
	while (isdigit(*p)) {
	    exp = exp * 10 + (*p - '0');
	    p += 1;
	}
    }
    if (expSign) {
	exp = fracExp - exp;
    } else {
	exp = fracExp + exp;
    }
    /*
     * Generate a floating-point number that represents the exponent.
     * Do this by processing the exponent one bit at a time to combine
     * many powers of 2 of 10. Then combine the exponent with the
     * fraction.
     */
    
    if (exp < 0) {
	expSign = TRUE;
	exp = -exp;
    } else {
	expSign = FALSE;
    }
    if (exp > maxExponent) {
	exp = maxExponent;
	errno = ERANGE;
    }
    dblExp = 1.0;
    for (d = powersOf10; exp != 0; exp >>= 1, d += 1) {
	if (exp & 01) {
	    dblExp *= *d;
	}
    }
    if (expSign) {
	fraction /= dblExp;
    } else {
	fraction *= dblExp;
    }
done:
    if (endPtr != NULL) {
	*endPtr = (char *) p;
    }
    if (sign) {
	return -fraction;
    }
    return fraction;
}
/*
 * Implementations added for emscripten.
 */
// XXX add real support for long double
long double
strtold(const char* nptr, char **endptr)
{
  return (long double) strtod(nptr, endptr);
}
// use stdtod to handle strtof
float
strtof(const char* nptr, char **endptr)
{
  return (float) strtof(nptr, endptr);
}
// XXX no locale support yet
double
strtod_l(const char* nptr, char **endptr, locale_t loc)
{
  return strtod(nptr, endptr);
}
long double
strtold_l(const char* nptr, char **endptr, locale_t loc)
{
  return strtold(nptr, endptr);
}
double atof(const char* str)
{
  return strtod(str, (char **) NULL);
}
```
