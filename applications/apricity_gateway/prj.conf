## CMakeLists.txt
```
#
# Copyright (c) 2018 Nordic Semiconductor
#
# SPDX-License-Identifier: LicenseRef-BSD-5-Clause-Nordic
#

cmake_minimum_required(VERSION 3.8.2)

# This sample runs as a non-secure application on nRF91. Therefore, it
# requires the secure_partition_manager that prepares the required
# peripherals to be available for the application.
#
# Configure the SPM image to enable the peripherals that this sample
# needs.
set(spm_CONF_FILE
  prj.conf
  ${CMAKE_CURRENT_LIST_DIR}/child_secure_partition_manager.conf
  )
  
include($ENV{ZEPHYR_BASE}/../nrf/cmake/boilerplate.cmake)
include($ENV{ZEPHYR_BASE}/cmake/app/boilerplate.cmake NO_POLICY_SCOPE)
project(lte-ble-gateway)
zephyr_compile_definitions(PROJECT_NAME=${PROJECT_NAME})
zephyr_compile_definitions(_POSIX_C_SOURCE=200809L)

# NORDIC SDK APP START
target_sources(app PRIVATE src/main.c)
# NORDIC SDK APP END
zephyr_include_directories(
src
src/ui
src/watchdog
)

target_sources(app PRIVATE src/ble.c)
target_sources(app PRIVATE src/ble_codec.c)
target_sources(app PRIVATE src/ble_conn_mgr.c)
target_sources(app PRIVATE src/gateway.c)
target_sources(app PRIVATE src/dfu/peripheral_dfu.c)

add_subdirectory(src/ui)
add_subdirectory_ifdef(CONFIG_WATCHDOG src/watchdog)
```

## Kconfig
```
#
# Copyright (c) 2018 Nordic Semiconductor ASA
#
# SPDX-License-Identifier: LicenseRef-BSD-5-Clause-Nordic
#

menu "Application sample"

rsource "src/ui/Kconfig"

config APPLICATION_WORKQUEUE_STACK_SIZE
	int "Application workqueue stack size"
	default 4096

config APPLICATION_WORKQUEUE_PRIORITY
	int "Application workqueue priority"
	default SYSTEM_WORKQUEUE_PRIORITY

menu "Cloud"

config MQTT_KEEPALIVE
	int "Time after last transmission to send a ping to keep connection on"
	default 1200
	help
	  This should be set to the expected time between messages sent from
	  this device. Making it larger than the expected data period does not
	  conserve bandwidth, as the ping is only sent if nothing else
	  has been within the specified period. Shorter values can prevent hidden
	  NAT timeouts at the carrier, but also will interrupt GPS fix attempts
	  and slow down TTFF.

config CLOUD_BUTTON
	bool "Enable button sensor"
	default y

config CLOUD_BUTTON_INPUT
	int "Set button sensor button number"
	range 1 4 if BOARD_NRF9160_PCA10090NS
	range 1 1 if BOARD_NRF9160_APRGWNS
	default 1

config CLOUD_CONNECT_RETRY_DELAY
	int "Cloud connection retry delay in seconds"
	default 480
	help
	  Time to wait before trying to connect to the cloud again if the
	  previous attempt failed (in seconds).

config CLOUD_CONNECT_COUNT_MAX
	int "Maximum number of cloud connection attempts"
	default 8

config CLOUD_WAIT_DURATION
	int "Cloud connection acknowledge wait duration"
	default 30
	help
	  How long the device should wait for a CONNACK
	  event from the cloud.

config CLOUD_FOTA_APP
	bool "Enable firmware over-the-air upgrades for application"
	depends on AWS_FOTA
	depends on DFU_TARGET_MCUBOOT
	default y

config CLOUD_FOTA_MODEM
	bool "Enable firmware over-the-air upgrades for modem"
	depends on AWS_FOTA
	depends on DFU_TARGET_MODEM
	default y

config CLOUD_CONNECT_ERR_REBOOT_S
	int "Seconds to wait before rebooting when a cloud connect error occurs"
	default 300

endmenu # Cloud


choice
	prompt "GPS device"
	default GPS_USE_SIM
	help
		Select from which device GPS data will be fetched.

config GPS_USE_SIM
	bool "Use GPS simulator"
	select GPS_SIM
	select GPS_SIM_TRIGGER
	help
		Use simulated GPS data.

config GPS_USE_EXTERNAL
	bool "User provided GPS device"
	help
		Provide a GPS device that location data will be fetched from and
		sent to nRF Cloud

endchoice

if GPS_USE_SIM

config GPS_DEV_NAME
	string
	default GPS_SIM_DEV_NAME

config GPS_TRIGGER
	bool
	default GPS_SIM_TRIGGER

endif

if GPS_USE_EXTERNAL
config GPS_DEV_NAME
	string "GPS device name"
	help
		GPS device from which location data will be fetched and sent
		to nRF Cloud.

endif

choice
	prompt "nRF Cloud user association"
	default CLOUD_UA_BUTTONS
	help
		Select which method to use for nRF Cloud user association
		input.

config CLOUD_UA_BUTTONS
	bool "Use buttons and switches"
	help
		Use buttons and switches on the development kit to provide
		user association input.

config CLOUD_UA_CONSOLE
	bool "Use console input"
	help
		Use console to enter nRF Cloud user association input.
		Allowed input is as follows:
		'b1' = Button 1
		'b2' = Button 2
		's1' = Switch 1
		's2' = Switch 2

endchoice

config APR_GATEWAY
	bool "Apricity Gateway"
	default y
  help
    Defines if gateway

endmenu

menu "Zephyr Kernel"
source "$ZEPHYR_BASE/Kconfig.zephyr"
endmenu

module = APRICITY_GATEWAY
module-str = Apricity Gateway
source "${ZEPHYR_BASE}/subsys/logging/Kconfig.template.log_config"
```

## sample.yaml
```
sample:
  name: LTE-BLE gateway sample
tests:
  test_build:
    build_only: true
    build_on_all: true
    platform_whitelist: nrf9160_aprgwns
    tags: ci_build
```

## prj.conf
```kconfig
#
# Copyright (c) 2019 Nordic Semiconductor ASA
#
# SPDX-License-Identifier: LicenseRef-BSD-5-Clause-Nordic
#
# General config
CONFIG_NEWLIB_LIBC=y
CONFIG_TEST_RANDOM_GENERATOR=y
CONFIG_ASSERT=y
CONFIG_REBOOT=y

# Network
CONFIG_NETWORKING=y
CONFIG_NET_NATIVE=n
CONFIG_NET_SOCKETS=y
CONFIG_NET_SOCKETS_OFFLOAD=y

# LTE link control
CONFIG_LTE_LINK_CONTROL=y
CONFIG_LTE_AUTO_INIT_AND_CONNECT=n

# AT host
CONFIG_AT_HOST_LIBRARY=y

# BSD library
CONFIG_BSD_LIBRARY=y

# Disable Modem traces, since we need UART1 for HCI
CONFIG_BSD_LIBRARY_TRACE_ENABLED=n

# nRF Cloud
CONFIG_NRF_CLOUD=y

# Sensors
CONFIG_GPS_USE_SIM=y

# Library for buttons and LEDs
CONFIG_DK_LIBRARY=y
CONFIG_DK_LIBRARY_INVERT_LEDS=n

# Console for user association
CONFIG_CONSOLE_SUBSYS=y
CONFIG_CONSOLE_GETCHAR=y

# Enable Bluetooth stack and libraries
CONFIG_BT=y
CONFIG_BT_H4=y
CONFIG_BT_WAIT_NOP=y
CONFIG_BT_CENTRAL=y
CONFIG_BT_GATT_CLIENT=y
CONFIG_BT_GATT_DM=y
CONFIG_BT_SCAN=y
CONFIG_BT_SCAN_FILTER_ENABLE=y
CONFIG_BT_SCAN_UUID_CNT=1

CONFIG_UART_2_NRF_UARTE=y
CONFIG_UART_2_NRF_FLOW_CONTROL=y
CONFIG_UART_INTERRUPT_DRIVEN=y

# Heap and stacks
CONFIG_HEAP_MEM_POOL_SIZE=16384
CONFIG_MAIN_STACK_SIZE=8192
CONFIG_GPS_SIM_THREAD_STACK_SIZE=2048

CONFIG_MQTT_LOG_LEVEL_DBG=y

CONFIG_NRF_CLOUD_MQTT_MESSAGE_BUFFER_LEN=512
CONFIG_NRF_CLOUD_HOST_NAME="a2wg6q8yw7gv5r-ats.iot.us-east-1.amazonaws.com"

CONFIG_DEVICE_ID="apr-123456"
```

## child_secure_partition_manager.conf
```kconfig
#
# Copyright (c) 2019 Nordic Semiconductor ASA
#
# SPDX-License-Identifier: LicenseRef-BSD-5-Clause-Nordic

CONFIG_IS_SPM=y
CONFIG_FW_INFO=y
CONFIG_GPIO=n
#
# Set UARTE2 as non-secure, used for HCI
CONFIG_SPM_NRF_UARTE2_NS=y
```

## prj_nrf9160_aprgwns.conf
```kconfig
#
# Copyright (c) 2019 Nordic Semiconductor ASA
#
# SPDX-License-Identifier: LicenseRef-BSD-5-Clause-Nordic
#
# General config
CONFIG_NEWLIB_LIBC=y
CONFIG_NEWLIB_LIBC_FLOAT_PRINTF=y
CONFIG_ASSERT=y
CONFIG_REBOOT=y
CONFIG_LOG=y
CONFIG_LOG_IMMEDIATE=y

# Network
CONFIG_NETWORKING=y
CONFIG_NET_SOCKETS=y
CONFIG_NET_SOCKETS_OFFLOAD=y

# MQTT
# CONFIG_MQTT_SOCKET_LIB=y
# CONFIG_MQTT_LIB_TLS=y
# CONFIG_MQTT_MAX_PACKET_LENGTH=2048

# MQTT
CONFIG_MQTT_LIB=y
CONFIG_MQTT_LIB_TLS=y

# AWS FOTA
CONFIG_AWS_FOTA=y
CONFIG_CLIENT_ID_MAX_LEN=64
CONFIG_FOTA_SOCKET_RETRIES=8

# FOTA Download
CONFIG_FOTA_DOWNLOAD=y

# Download Client
CONFIG_DOWNLOAD_CLIENT=y
CONFIG_DOWNLOAD_CLIENT_STACK_SIZE=4096

# DFU Target
CONFIG_DFU_TARGET=y
CONFIG_DFU_TARGET_MCUBOOT_SAVE_PROGRESS=n

# Settings
CONFIG_SETTINGS=y
CONFIG_SETTINGS_NVS=y

# Non-volatile Storage
CONFIG_NVS=y

CONFIG_NRF_CLOUD_MQTT_PAYLOAD_BUFFER_LEN=4096

# LTE link control
CONFIG_LTE_LINK_CONTROL=y
CONFIG_LTE_NETWORK_MODE_LTE_M_GPS=y
CONFIG_LTE_AUTO_INIT_AND_CONNECT=n
CONFIG_LTE_LINK_CONTROL_LOG_LEVEL_DBG=y

CONFIG_LTE_NETWORK_MODE_NBIOT=n
CONFIG_LTE_LEGACY_PCO_MODE=n
CONFIG_LTE_PSM_REQ_RPTAU="00000110"
CONFIG_LTE_PSM_REQ_RAT="00000000"

CONFIG_LTE_LOCK_BANDS=y
# Enable band 2, 3, 4, 8, 12, 13 ,20 and 28
CONFIG_LTE_LOCK_BAND_MASK="1000000010000001100010001110"

# Modem info
CONFIG_MODEM_INFO=y
CONFIG_MODEM_INFO_ADD_SIM_ICCID=n

# AT host
CONFIG_AT_HOST_LIBRARY=y

# BSD library
CONFIG_BSD_LIBRARY=y
CONFIG_BSD_LIBRARY_TRACE_ENABLED=n

# nRF Cloud
CONFIG_CLOUD_API=y
CONFIG_NRF_CLOUD=y
CONFIG_NRF_CLOUD_LOG_LEVEL_DBG=y

# Library for buttons and LEDs
CONFIG_DK_LIBRARY=y
CONFIG_DK_LIBRARY_INVERT_LEDS=y

# Console
CONFIG_CLOUD_UA_BUTTONS=n
CONFIG_CLOUD_UA_CONSOLE=n
CONFIG_CONSOLE_SUBSYS=y
CONFIG_CONSOLE_HANDLER=y
CONFIG_CONSOLE_GETCHAR=y

# Enable Bluetooth stack and libraries
CONFIG_BT=y
CONFIG_BT_H4=y
CONFIG_BT_WAIT_NOP=y
CONFIG_BT_CENTRAL=y
CONFIG_BT_GATT_CLIENT=y
CONFIG_BT_GATT_DM=y
CONFIG_BT_SCAN=y
CONFIG_BT_SCAN_FILTER_ENABLE=n
CONFIG_BT_SCAN_NAME_CNT=0
#TODO: Change back to 8
CONFIG_BT_MAX_CONN=6   
CONFIG_BT_GATT_DM_MAX_ATTRS=100
CONFIG_BT_GATT_DM_MAX_MEM_CHUNKS=20
CONFIG_BT_WHITELIST=y


CONFIG_BT_CTLR_DUP_FILTER_LEN=16

CONFIG_UART_1_NRF_UARTE=y
CONFIG_UART_1_NRF_FLOW_CONTROL=y
CONFIG_UART_INTERRUPT_DRIVEN=y
CONFIG_BT_UART_ON_DEV_NAME="UART_1"

# Main thread
CONFIG_MAIN_THREAD_PRIORITY=7

# Heap and stacks
CONFIG_HEAP_MEM_POOL_SIZE=16384
CONFIG_MAIN_STACK_SIZE=4096

# Settings
CONFIG_FLASH=y
CONFIG_FLASH_PAGE_LAYOUT=y
CONFIG_FLASH_MAP=y
CONFIG_FCB=y
CONFIG_SETTINGS=y
CONFIG_SETTINGS_FCB=y
CONFIG_MPU_ALLOW_FLASH_WRITE=y
CONFIG_IMG_ERASE_PROGRESSIVELY=y

# MCUBOOT
CONFIG_BOOTLOADER_MCUBOOT=y
CONFIG_IMG_MANAGER=y
CONFIG_MCUBOOT_IMG_MANAGER=y

CONFIG_BOARD_NRF52840_GPIO_RESET=y
CONFIG_BOARD_NRF52840_GPIO_RESET_PIN=10

CONFIG_APR_GATEWAY=y

CONFIG_DEBUG_OPTIMIZATIONS=y

CONFIG_NRF91_SOCKET_SEND_SPLIT_LARGE_BLOCKS=y
CONFIG_NRF_CLOUD_CONNECTION_POLL_THREAD=y

# CONFIG_STACK_SIZE_ANALYZER=y
# CONFIG_STACK_SIZE_ANALYZER_USE_LOG=y
# CONFIG_STACK_SIZE_ANALYZER_AUTO=y
# CONFIG_THREAD_NAME=y

CONFIG_APPLICATION_WORKQUEUE_STACK_SIZE=1024
#CONFIG_CLOCK_CONTROL_NRF_K32SRC_SYNTH=y
CONFIG_CJSON_LIB=y

# CONFIG_NET_LOG=y
# CONFIG_MQTT_LOG_LEVEL_DBG=y
CONFIG_MQTT_KEEPALIVE=120
```

## src/main.c
```c
/*
 * Copyright (c) 2018 Nordic Semiconductor ASA
 *
 * SPDX-License-Identifier: LicenseRef-BSD-5-Clause-Nordic
 */

#include <zephyr.h>
#include <kernel_structs.h>
#include <stdio.h>
#include <string.h>
#include <drivers/gps.h>
#include <drivers/sensor.h>
#include <console/console.h>
#include <power/reboot.h>
#include <logging/log_ctrl.h>
#if defined(CONFIG_BSD_LIBRARY)
#include <net/bsdlib.h>
#include <bsd.h>
#include <lte_lc.h>
//#include <net/modem_info.h>
#endif /* CONFIG_BSD_LIBRARY */
#include <net/cloud.h>
#include <net/socket.h>
#include <nrf_cloud.h>
#if defined(CONFIG_NRF_CLOUD_AGPS)
#include <net/nrf_cloud_agps.h>
#endif

#if defined(CONFIG_BOOTLOADER_MCUBOOT)
#include <dfu/mcuboot.h>
#endif

#include "ui.h"
#include "watchdog.h"
#include "ble_conn_mgr.h"
#include "ble.h"


#include <logging/log.h>
#if !defined(CONFIG_NRF91_SOCKET_SEND_SPLIT_LARGE_BLOCKS)
LOG_MODULE_REGISTER(apricity_gateway_certs, CONFIG_APRICITY_GATEWAY_LOG_LEVEL);
#else
LOG_MODULE_REGISTER(apricity_gateway, CONFIG_APRICITY_GATEWAY_LOG_LEVEL);
#endif

#define CALIBRATION_PRESS_DURATION 	K_SECONDS(5)
#define CLOUD_CONNACK_WAIT_DURATION	K_SECONDS(CONFIG_CLOUD_WAIT_DURATION)

#if defined(CONFIG_BSD_LIBRARY) && \
!defined(CONFIG_LTE_LINK_CONTROL)
#error "Missing CONFIG_LTE_LINK_CONTROL"
#endif
#if defined(CONFIG_BSD_LIBRARY) && \
defined(CONFIG_LTE_AUTO_INIT_AND_CONNECT) && \
defined(CONFIG_NRF_CLOUD_PROVISION_CERTIFICATES)
#error "PROVISION_CERTIFICATES \
	requires CONFIG_LTE_AUTO_INIT_AND_CONNECT to be disabled!"
#endif

#define CLOUD_LED_ON_STR "{\"led\":\"on\"}"
#define CLOUD_LED_OFF_STR "{\"led\":\"off\"}"
#define CLOUD_LED_MSK UI_LED_1

/* Interval in milliseconds after which the device will reboot
 * if the disconnect event has not been handled.
 */
#define REBOOT_AFTER_DISCONNECT_WAIT_MS	K_SECONDS(15)

/* Interval in milliseconds after which the device will
 * disconnect and reconnect if association was not completed.
 */
#define CONN_CYCLE_AFTER_ASSOCIATION_REQ_MS	K_MINUTES(5)

struct rsrp_data {
	u16_t value;
	u16_t offset;
};

/* Stack definition for application workqueue */
K_THREAD_STACK_DEFINE(application_stack_area,
		      CONFIG_APPLICATION_WORKQUEUE_STACK_SIZE);
static struct k_work_q application_work_q;
static struct cloud_backend *cloud_backend;

static atomic_t cloud_connect_attempts;


#if IS_ENABLED(CONFIG_GPS_START_ON_MOTION)
/* Current state of activity monitor */
static motion_activity_state_t last_activity_state = MOTION_ACTIVITY_NOT_KNOWN;
#endif

/* Variable to keep track of nRF cloud association state. */
enum cloud_association_state {
	CLOUD_ASSOCIATION_STATE_INIT,
	CLOUD_ASSOCIATION_STATE_REQUESTED,
	CLOUD_ASSOCIATION_STATE_PAIRED,
	CLOUD_ASSOCIATION_STATE_RECONNECT,
	CLOUD_ASSOCIATION_STATE_READY,
};
static atomic_val_t cloud_association =
	ATOMIC_INIT(CLOUD_ASSOCIATION_STATE_INIT);


/* Structures for work */
static struct k_delayed_work cloud_reboot_work;
static struct k_delayed_work cycle_cloud_connection_work;
static struct k_delayed_work cloud_connect_work;
static struct k_work device_status_work;


#if defined(CONFIG_AT_CMD)
#define MODEM_AT_CMD_BUFFER_LEN (3000 + 1)
#else
#define MODEM_AT_CMD_NOT_ENABLED_STR "Error: AT Command driver is not enabled"
#define MODEM_AT_CMD_BUFFER_LEN (sizeof(MODEM_AT_CMD_NOT_ENABLED_STR))
#endif
#define MODEM_AT_CMD_RESP_TOO_BIG_STR "Error: AT Command response is too large to be sent"
#define MODEM_AT_CMD_MAX_RESPONSE_LEN (3000)

static K_SEM_DEFINE(modem_at_cmd_sem, 1, 1);


enum error_type {
	ERROR_CLOUD,
	ERROR_BSD_RECOVERABLE,
	ERROR_LTE_LC,
	ERROR_SYSTEM_FAULT
};

/* Forward declaration of functions */

static void work_init(void);
static void cycle_cloud_connection(struct k_work *work);
static void connection_evt_handler(const struct cloud_event *const evt);

static void shutdown_modem(void)
{
//#if defined(CONFIG_LTE_LINK_CONTROL)
//	/* Turn off and shutdown modem */
//	LOG_ERR("LTE link disconnect");
//	int err = lte_lc_power_off();
//
//	if (err) {
//		LOG_ERR("lte_lc_power_off failed: %d", err);
//	}
//#endif /* CONFIG_LTE_LINK_CONTROL */
//#if defined(CONFIG_BSD_LIBRARY)
//	LOG_ERR("Shutdown modem");
//	bsdlib_shutdown();
//#endif
}

/**@brief nRF Cloud error handler. */
void error_handler(enum error_type err_type, int err_code)
{
	atomic_set(&cloud_association, CLOUD_ASSOCIATION_STATE_INIT);

	if (err_type == ERROR_CLOUD) {
		shutdown_modem();
                printk("ERROR SHUTDOWN");
	}

#if !defined(CONFIG_DEBUG) && defined(CONFIG_REBOOT)
	LOG_PANIC();
	sys_reboot(0);
#else
	switch (err_type) {
	case ERROR_CLOUD:
		/* Blinking all LEDs ON/OFF in pairs (1 and 4, 2 and 3)
		 * if there is an application error.
		 */
		ui_led_set_pattern(UI_LED_ERROR_CLOUD);
		LOG_ERR("Error of type ERROR_CLOUD: %d", err_code);
	break;
	case ERROR_BSD_RECOVERABLE:
		/* Blinking all LEDs ON/OFF in pairs (1 and 3, 2 and 4)
		 * if there is a recoverable error.
		 */
		ui_led_set_pattern(UI_LED_ERROR_BSD_REC);
		LOG_ERR("Error of type ERROR_BSD_RECOVERABLE: %d", err_code);
	break;
	default:
		/* Blinking all LEDs ON/OFF in pairs (1 and 2, 3 and 4)
		 * undefined error.
		 */
		ui_led_set_pattern(UI_LED_ERROR_UNKNOWN);
		LOG_ERR("Unknown error type: %d, code: %d",
			err_type, err_code);
	break;
	}

	while (true) {
		k_cpu_idle();
	}
#endif /* CONFIG_DEBUG */
}

void cloud_error_handler(int err)
{
	error_handler(ERROR_CLOUD, err);
}

void cloud_connect_error_handler(enum cloud_connect_result err)
{
	bool reboot = true;
	char *backend_name = "invalid";

	if (err == CLOUD_CONNECT_RES_SUCCESS) {
		return;
	}

	LOG_ERR("Failed to connect to cloud, error %d", err);

	switch (err) {
	case CLOUD_CONNECT_RES_ERR_NOT_INITD: {
		LOG_ERR("Cloud back-end has not been initialized");
		/* no need to reboot, program error */
		reboot = false;
		break;
	}
	case CLOUD_CONNECT_RES_ERR_NETWORK: {
		LOG_ERR("Network error, check cloud configuration");
		break;
	}
	case CLOUD_CONNECT_RES_ERR_BACKEND: {
		if (cloud_backend && cloud_backend->config &&
		    cloud_backend->config->name) {
			backend_name = cloud_backend->config->name;
		}
		LOG_ERR("An error occurred specific to the cloud back-end: %s",
			backend_name);
		break;
	}
	case CLOUD_CONNECT_RES_ERR_PRV_KEY: {
		LOG_ERR("Ensure device has a valid private key");
		break;
	}
	case CLOUD_CONNECT_RES_ERR_CERT: {
		LOG_ERR("Ensure device has a valid CA and client certificate");
		break;
	}
	case CLOUD_CONNECT_RES_ERR_CERT_MISC: {
		LOG_ERR("A certificate/authorization error has occurred");
		break;
	}
	case CLOUD_CONNECT_RES_ERR_TIMEOUT_NO_DATA: {
		LOG_ERR("Connect timeout. SIM card may be out of data");
		break;
	}
	case CLOUD_CONNECT_RES_ERR_ALREADY_CONNECTED: {
		LOG_ERR("Connection already exists.");
		break;
	}
	case CLOUD_CONNECT_RES_ERR_MISC: {
		break;
	}
	default: {
		LOG_ERR("Unhandled connect error");
		break;
	}
	}

	if (reboot) {
		LOG_ERR("Device will reboot in %d seconds",
				CONFIG_CLOUD_CONNECT_ERR_REBOOT_S);
		k_delayed_work_submit_to_queue(
			&application_work_q, &cloud_reboot_work,
			K_SECONDS(CONFIG_CLOUD_CONNECT_ERR_REBOOT_S));
	}

	ui_led_set_pattern(UI_LED_ERROR_CLOUD);
	shutdown_modem();
	k_thread_suspend(k_current_get());
}

/**@brief Recoverable BSD library error. */
void bsd_recoverable_error_handler(uint32_t err)
{
	error_handler(ERROR_BSD_RECOVERABLE, (int)err);
}

void connect_to_cloud(const s32_t connect_delay_s)
{
	static bool initial_connect = true;

	/* Ensure no data can be sent to cloud before connection is established.
	 */
	atomic_set(&cloud_association, CLOUD_ASSOCIATION_STATE_INIT);
	atomic_inc(&cloud_connect_attempts);

	/* Check if max cloud connect retry count is exceeded. */
	if (atomic_get(&cloud_connect_attempts) >
	    CONFIG_CLOUD_CONNECT_COUNT_MAX) {
		LOG_ERR("The max cloud connection attempt count exceeded.");
		cloud_error_handler(-ETIMEDOUT);
	}

	if (!initial_connect) {
		LOG_INF("Attempting reconnect in %d seconds...",
			connect_delay_s);
		k_delayed_work_cancel(&cloud_reboot_work);
	} else {
		initial_connect =  false;
	}

	k_delayed_work_submit_to_queue(&application_work_q,
				       &cloud_connect_work,
				       K_SECONDS(connect_delay_s));
}

static void cloud_connect_work_fn(struct k_work *work)
{
	int ret;

	LOG_INF("Connecting to cloud, attempt %d of %d",
	       atomic_get(&cloud_connect_attempts),
		   CONFIG_CLOUD_CONNECT_COUNT_MAX);

	k_delayed_work_submit_to_queue(&application_work_q,
			&cloud_reboot_work,
			CLOUD_CONNACK_WAIT_DURATION);

	ui_led_set_pattern(UI_CLOUD_CONNECTING);

	/* Attempt cloud connection */
	ret = cloud_connect(cloud_backend);
	if (ret != CLOUD_CONNECT_RES_SUCCESS) {
		k_delayed_work_cancel(&cloud_reboot_work);
		/* Will not return from this function.
		 * If the connect fails here, it is likely
		 * that user intervention is required.
		 */
		cloud_connect_error_handler(ret);
	} else {
		LOG_INF("Cloud connection request sent.");
		LOG_INF("Connection response timeout is set to %d seconds.",
		       CLOUD_CONNACK_WAIT_DURATION / MSEC_PER_SEC);
//		k_delayed_work_submit_to_queue(&application_work_q,
//					       &cloud_reboot_work,
//					       CLOUD_CONNACK_WAIT_DURATION);
	}
}

/**@brief Reboot the device if CONNACK has not arrived. */
static void cloud_reboot_handler(struct k_work *work)
{
	error_handler(ERROR_CLOUD, -ETIMEDOUT);
        printk("Cloud Error: Device Reboot\n");
}

/**@brief nRF Cloud specific callback for cloud association event. */
static void on_user_pairing_req(const struct cloud_event *evt)
{
	if (atomic_get(&cloud_association) !=
		CLOUD_ASSOCIATION_STATE_REQUESTED) {
		atomic_set(&cloud_association,
				   CLOUD_ASSOCIATION_STATE_REQUESTED);
		ui_led_set_pattern(UI_CLOUD_PAIRING);
		LOG_INF("Add device to cloud account.");
		LOG_INF("Waiting for cloud association...");

		/* If the association is not done soon enough (< ~5 min?)
		 * a connection cycle is needed... TBD why.
		 */
		k_delayed_work_submit_to_queue(&application_work_q,
					       &cycle_cloud_connection_work,
					       CONN_CYCLE_AFTER_ASSOCIATION_REQ_MS);
	}
}

static void cycle_cloud_connection(struct k_work *work)
{
	s32_t reboot_wait_ms = REBOOT_AFTER_DISCONNECT_WAIT_MS;

	LOG_INF("Disconnecting from cloud...");

	if (cloud_disconnect(cloud_backend) != 0) {
		reboot_wait_ms = K_SECONDS(5);
		LOG_INF("Disconnect failed. Device will reboot in %d seconds",
			(reboot_wait_ms / MSEC_PER_SEC));
	}

	/* Reboot fail-safe on disconnect */
	k_delayed_work_submit_to_queue(&application_work_q, &cloud_reboot_work,
				       reboot_wait_ms);
}

/** @brief Handle procedures after successful association with nRF Cloud. */
void on_pairing_done(void)
{
	if (atomic_get(&cloud_association) ==
			CLOUD_ASSOCIATION_STATE_REQUESTED) {
		k_delayed_work_cancel(&cycle_cloud_connection_work);

		/* After successful association, the device must
		 * reconnect to the cloud.
		 */
		LOG_INF("Device associated with cloud.");
		LOG_INF("Reconnecting for cloud policy to take effect.");
		atomic_set(&cloud_association,
				   CLOUD_ASSOCIATION_STATE_RECONNECT);
		k_delayed_work_submit_to_queue(&application_work_q,
					       &cycle_cloud_connection_work,
					       K_NO_WAIT);
	} else {
		atomic_set(&cloud_association, CLOUD_ASSOCIATION_STATE_PAIRED);
	}
}

void cloud_event_handler(const struct cloud_backend *const backend,
			 const struct cloud_event *const evt,
			 void *user_data)
{
	ARG_UNUSED(user_data);

	switch (evt->type) {
	case CLOUD_EVT_CONNECTED:
	case CLOUD_EVT_CONNECTING:
	case CLOUD_EVT_DISCONNECTED:
		connection_evt_handler(evt);
		break;
	case CLOUD_EVT_READY:
		LOG_INF("CLOUD_EVT_READY");
		ui_led_set_pattern(UI_CLOUD_CONNECTED);
#if defined(CONFIG_BOOTLOADER_MCUBOOT)
		/* Mark image as good to avoid rolling back after update */
		boot_write_img_confirmed();
#endif
		atomic_set(&cloud_association, CLOUD_ASSOCIATION_STATE_READY);
//		sensors_start();
		break;
	case CLOUD_EVT_ERROR:
		LOG_INF("CLOUD_EVT_ERROR");
		break;
	case CLOUD_EVT_DATA_SENT:
		LOG_INF("CLOUD_EVT_DATA_SENT");
		break;
	case CLOUD_EVT_DATA_RECEIVED: {
		int err;

		LOG_INF("CLOUD_EVT_DATA_RECEIVED");
	}
	case CLOUD_EVT_PAIR_REQUEST:
		LOG_INF("CLOUD_EVT_PAIR_REQUEST");

                //Remove BLE devices if device was deleted.
                ble_conn_mgr_clear_desired();
                ble_conn_mgr_update_connections();
                ble_clear_discover_inprogress();

		on_user_pairing_req(evt);
		break;
	case CLOUD_EVT_PAIR_DONE:
		LOG_INF("CLOUD_EVT_PAIR_DONE");
		on_pairing_done();
		break;
	case CLOUD_EVT_FOTA_DONE:
		LOG_INF("CLOUD_EVT_FOTA_DONE");
#if defined(CONFIG_LTE_LINK_CONTROL)
		lte_lc_power_off();
#endif
		sys_reboot(SYS_REBOOT_COLD);
		break;
	default:
		LOG_WRN("Unknown cloud event type: %d", evt->type);
		break;
	}
}

void connection_evt_handler(const struct cloud_event *const evt)
{
	if (evt->type == CLOUD_EVT_CONNECTING) {
		LOG_INF("CLOUD_EVT_CONNECTING");
		ui_led_set_pattern(UI_CLOUD_CONNECTING);
		k_delayed_work_cancel(&cloud_reboot_work);

		if (evt->data.err != CLOUD_CONNECT_RES_SUCCESS) {

			cloud_connect_error_handler(evt->data.err);
		}
		return;
	} else if (evt->type == CLOUD_EVT_CONNECTED) {
		LOG_INF("CLOUD_EVT_CONNECTED");
		k_delayed_work_cancel(&cloud_reboot_work);
		atomic_set(&cloud_connect_attempts, 0);
		ui_led_set_pattern(UI_CLOUD_CONNECTED);
#if defined(CONFIG_CLOUD_PERSISTENT_SESSIONS)
		LOG_INF("Persistent Sessions = %u",
			evt->data.persistent_session);
#endif
	} else if (evt->type == CLOUD_EVT_DISCONNECTED) {
		s32_t connect_wait_s = CONFIG_CLOUD_CONNECT_RETRY_DELAY;

		LOG_INF("CLOUD_EVT_DISCONNECTED: %d", evt->data.err);
		ui_led_set_pattern(UI_LTE_CONNECTED);

		switch (evt->data.err)
		{
		case CLOUD_DISCONNECT_ERR_CLOSED_BY_REMOTE:
			if ((atomic_get(&cloud_connect_attempts) == 1) &&
			    (atomic_get(&cloud_association) ==
			     CLOUD_ASSOCIATION_STATE_INIT)) {
				LOG_INF("Disconnected by the cloud.");
				LOG_INF("This can occur during provisioning or when the device has invalid certificates.");
				connect_wait_s = 10;
			}
			break;
		case CLOUD_DISCONNECT_ERR_USER_REQUEST:
			if (atomic_get(&cloud_association) ==
			    CLOUD_ASSOCIATION_STATE_RECONNECT ||
			    atomic_get(&cloud_association) ==
			    CLOUD_ASSOCIATION_STATE_REQUESTED) {
				connect_wait_s = 10;
			}
			break;
		case CLOUD_DISCONNECT_ERR_MISC:
		case CLOUD_DISCONNECT_ERR_INVALID_REQUEST:
		default:
			break;
		}
		connect_to_cloud(connect_wait_s);
	}
}

/**@brief Initializes and submits delayed work. */
static void work_init(void)
{

	k_delayed_work_init(&cloud_reboot_work, cloud_reboot_handler);
	k_delayed_work_init(&cycle_cloud_connection_work,
			    cycle_cloud_connection);
	k_delayed_work_init(&cloud_connect_work, cloud_connect_work_fn);

}

/**@brief Configures modem to provide LTE link. Blocks until link is
 * successfully established.
 */
static int modem_configure(void)
{
#if defined(CONFIG_BSD_LIBRARY)
	if (IS_ENABLED(CONFIG_LTE_AUTO_INIT_AND_CONNECT)) {
		/* Do nothing, modem is already turned on
		 * and connected.
		 */
	} else {
		int err;

		LOG_INF("Connecting to LTE network. ");
		LOG_INF("This may take several minutes.");
		ui_led_set_pattern(UI_LTE_CONNECTING);

		err = lte_lc_init_and_connect();
		if (err) {
			LOG_ERR("LTE link could not be established.");
			ui_led_set_pattern(UI_LED_ERROR_LTE_LC);
			return err;
		}

		LOG_INF("Connected to LTE network");
		ui_led_set_pattern(UI_LTE_CONNECTED);
	}
#endif
	return 0;
}

void handle_bsdlib_init_ret(void)
{
	#if defined(CONFIG_BSD_LIBRARY)
	int ret = bsdlib_get_init_ret();

	/* Handle return values relating to modem firmware update */
	switch (ret) {
	case MODEM_DFU_RESULT_OK:
		LOG_INF("MODEM UPDATE OK. Will run new firmware");
		sys_reboot(SYS_REBOOT_COLD);
		break;
	case MODEM_DFU_RESULT_UUID_ERROR:
	case MODEM_DFU_RESULT_AUTH_ERROR:
		LOG_ERR("MODEM UPDATE ERROR %d. Will run old firmware", ret);
		sys_reboot(SYS_REBOOT_COLD);
		break;
	case MODEM_DFU_RESULT_HARDWARE_ERROR:
	case MODEM_DFU_RESULT_INTERNAL_ERROR:
		LOG_ERR("MODEM UPDATE FATAL ERROR %d. Modem failiure", ret);
		sys_reboot(SYS_REBOOT_COLD);
		break;
	default:
		break;
	}
	#endif /* CONFIG_BSD_LIBRARY */
}

void main(void)
{
	int ret;

	LOG_INF("Gateway started; rebuilt: %s %s", __DATE__, __TIME__);
        ble_init();

	k_work_q_start(&application_work_q, application_stack_area,
		       K_THREAD_STACK_SIZEOF(application_stack_area),
		       CONFIG_APPLICATION_WORKQUEUE_PRIORITY);
	if (IS_ENABLED(CONFIG_WATCHDOG)) {
		watchdog_init_and_start(&application_work_q);
	}

	handle_bsdlib_init_ret();

	cloud_backend = cloud_get_binding("NRF_CLOUD");
	__ASSERT(cloud_backend != NULL, "nRF Cloud backend not found");

	ret = cloud_init(cloud_backend, cloud_event_handler);
	if (ret) {
		LOG_ERR("Cloud backend could not be initialized, error: %d",
			ret);
		cloud_error_handler(ret);
	}

#if defined(CONFIG_USE_UI_MODULE)
	ui_init(NULL);
#endif

	work_init();

	while (modem_configure() != 0) {
		LOG_WRN("Failed to establish LTE connection.");
		LOG_WRN("Will retry in %d seconds.",
				CONFIG_CLOUD_CONNECT_RETRY_DELAY);
		k_sleep(K_SECONDS(CONFIG_CLOUD_CONNECT_RETRY_DELAY));
	}

	connect_to_cloud(K_NO_WAIT);
}
```

## src/ble_codec.h
```c
#ifndef BLE_CODEC_H_
#define BLE_CODEC_H_

//#include "ble.h"
#include "cJSON.h"
#include "ble_conn_mgr.h"

u8_t device_found_encode(u8_t num_devices_found);
u8_t device_connect_result_encode(char* ble_address, bool conn_status);
u8_t device_discovery_result_encode(char* ble_address, bool conn_status, char *discovered_json);
u8_t device_value_changed_encode(char* ble_address, char* uuid, char* path, char* value, u16_t value_length);
u8_t device_chrc_read_encode(char* ble_address, char* uuid, char* path, char* value, u16_t value_length);
u8_t create_device_wrapper(char* ble_address, bool conn_status);
u8_t device_discovery_add_attr(char *discovered_json, bool last_attr);
u8_t device_discovery_send();
u8_t device_discovery_encode(connected_ble_devices* conn_ptr);
u8_t device_value_write_result_encode(char* ble_address, char* uuid, char* path, char* value, u16_t value_length);
u8_t device_descriptor_value_changed_encode(char* ble_address, char* uuid, char* path, char* value, u16_t value_length);
u8_t device_error_encode(char* ble_address, char* error_msg);
u8_t device_shadow_delete_encode();
u8_t device_disconnect_result_encode(char* ble_address, bool conn_status);
#endif
```

## src/ble_conn_mgr.c
```c
#include <zephyr.h>
#include <stdio.h>
#include <string.h>
#include <bluetooth/uuid.h>
#include <bluetooth/gatt.h>

#include "ble_conn_mgr.h"
#include "ble_codec.h"
#include "cJSON.h"
#include "ble.h"

#include <logging/log.h>
LOG_MODULE_REGISTER(ble_conn_mgr, CONFIG_LOG_DEFAULT_LEVEL);

static connected_ble_devices connected_ble_device[CONFIG_BT_MAX_CONN];

typedef struct
{
        char addr[DEVICE_ADDR_LEN];
        bool active;

} desired_conns;

static desired_conns desired_connection[CONFIG_BT_MAX_CONN];

#define CONN_MGR_STACK_SIZE 1600
#define CONN_MGR_PRIORITY 1

void connection_manager(int unused1, int unused2, int unused3)
{

        int err;
        ble_conn_mgr_init();
        while (1)
        {

                for(int i = 0; i<CONFIG_BT_MAX_CONN; i++)
                {
                        //Manager is busy. Do nothing.
                        if(connected_ble_device[i].discovering)
                        {
                                LOG_DBG("Connection work busy.");
                                goto end;
                        }
                }

                for(int i = 0; i<CONFIG_BT_MAX_CONN; i++)
                {

                        if(connected_ble_device[i].free == false)
                        {
                                //Add devices to whitelist
                                if(!connected_ble_device[i].added_to_whitelist)
                                {
                                        ble_add_to_whitelist(connected_ble_device[i].addr, connected_ble_device[i].addr_type);
                                        connected_ble_device[i].added_to_whitelist = true;
                                        device_shadow_data_encode(connected_ble_device[i].addr, true, false); //Maybe not the right spot to send this. IDK.
                                        LOG_INF("Device added to whitelist.");

                                }

                                //Not connected. Update the shadow
                                if(connected_ble_device[i].connected == true && !connected_ble_device[i].shadow_updated)
                                {
                                        device_shadow_data_encode(connected_ble_device[i].addr, false, true); //Maybe not the right spot to send this. IDK.
                                        connected_ble_device[i].shadow_updated = true;
                                }

                                //Connected. Do discoverying if not discoveryed or currently discovering
                                if( connected_ble_device[i].connected == true && connected_ble_device[i].discovered == false && !connected_ble_device[i].discovering)
                                {

                                        err = ble_discover(connected_ble_device[i].addr, connected_ble_device[i].addr_type);

                                        if(!err)
                                        {
                                                connected_ble_device[i].discovered = true;
                                        }

                                }

                                //Discoverying done. Encode and send.
                                if(connected_ble_device[i].connected == true && connected_ble_device[i].encode_discovered == true)
                                {

                                        u32_t lock = irq_lock(); //I don't know why this is needed in a work thread. TODO: FIX

                                        connected_ble_device[i].encode_discovered = false;
                                        device_discovery_encode(&connected_ble_device[i]);

                                        irq_unlock(lock);

                                        device_shadow_data_encode(connected_ble_device[i].addr, false, true); //Maybe not the right spot to send this. IDK.

                                }

                        }

                }

end:
                k_sleep(1000);
        }

}

K_THREAD_DEFINE(conn_mgr_thread, CONN_MGR_STACK_SIZE,
                connection_manager, NULL, NULL, NULL,
                CONN_MGR_PRIORITY, 0, K_NO_WAIT);


static void ble_conn_mgr_conn_reset(u8_t conn)
{
        connected_ble_device[conn].free = true;
        connected_ble_device[conn].added_to_whitelist = false;
        connected_ble_device[conn].connected = false;
        connected_ble_device[conn].discovered = false;
        connected_ble_device[conn].encode_discovered = false;
        connected_ble_device[conn].disconnect = false;
}

void ble_conn_mgr_update_connections()
{

        for(int i=0; i<CONFIG_BT_MAX_CONN; i++)
        {

                if(connected_ble_device[i].connected == true)
                {
                        connected_ble_device[i].disconnect = true;

                        for(int j=0; j<CONFIG_BT_MAX_CONN; j++)
                        {
                                if(desired_connection[j].active)
                                {
                                        if(!strcmp(desired_connection[j].addr, connected_ble_device[i].addr))
                                        {
                                                //If in the list then don't disconnect
                                                connected_ble_device[i].disconnect = false;
                                        }
                                }
                        }



                        if(connected_ble_device[i].disconnect)
                        {

                                LOG_INF("Device disconnecting");
                                ble_remove_from_whitelist(connected_ble_device[i].addr, connected_ble_device[i].addr_type);
                                disconnect_device_by_addr(connected_ble_device[i].addr, connected_ble_device[i].addr_type);
                                ble_conn_mgr_conn_reset(i);
                        }

                }
        }
}


void ble_conn_mgr_update_desired(char* addr, u8_t index)
{

        if(index <= CONFIG_BT_MAX_CONN)
        {

                memcpy(desired_connection[index].addr, addr, strlen(addr));
                desired_connection[index].active = true;

                LOG_INF("Desired Connection Added: %s", desired_connection[index].addr);
        }

}

void ble_conn_mgr_clear_desired()
{

        LOG_INF("Desired Connections Cleared.");

        for(int i = 0; i<CONFIG_BT_MAX_CONN; i++)
        {
                desired_connection[i].active = false;
        }

}

void ble_conn_mgr_generate_path(connected_ble_devices* conn_ptr, u16_t handle, char* path, bool ccc)
{

        char path_str[BT_MAX_PATH_LEN];
        char service_uuid[BT_UUID_STR_LEN];
        char ccc_uuid[BT_UUID_STR_LEN];
        char chrc_uuid[BT_UUID_STR_LEN];

        u8_t path_depth = 0;

        LOG_DBG("Num Pairs: %d", conn_ptr->num_pairs);

        for(int i=0; i< conn_ptr->num_pairs; i++)
        {

                if(handle == conn_ptr->uuid_handle_pair[i].handle)
                {

                        path_depth = conn_ptr->uuid_handle_pair[i].path_depth;
                        LOG_DBG("Path Depth %d", path_depth);

                        bt_uuid_get_str(&conn_ptr->uuid_handle_pair[i].uuid_128.uuid, chrc_uuid, BT_MAX_UUID_LEN);
                        bt_uuid_get_str(&conn_ptr->uuid_handle_pair[i+1].uuid_128.uuid, ccc_uuid, BT_MAX_UUID_LEN);

                        for(int j = i; j>=0; j--)
                        {
                                if(conn_ptr->uuid_handle_pair[j].is_service)
                                {
                                        bt_uuid_get_str(&conn_ptr->uuid_handle_pair[j].uuid_128.uuid, service_uuid, BT_MAX_UUID_LEN);
                                        LOG_DBG("service uuid in path %s", service_uuid);
                                        break;
                                }
                        }

                        snprintk(path_str, BT_MAX_PATH_LEN, "%s/%s", service_uuid, chrc_uuid);

                        if(ccc)
                        {
                                snprintk(path_str, BT_MAX_PATH_LEN, "%s/%s/%s", service_uuid, chrc_uuid, ccc_uuid);
                        }
                }
        }

        bt_to_upper(path_str, strlen(path_str));
        memset(path, 0, BT_MAX_PATH_LEN);
        memcpy(path, path_str, strlen(path_str));

        LOG_INF("Generated Path: %s", path_str);

}

u8_t ble_conn_mgr_add_conn(char* addr, char* addr_type)
{

        int err = 0;

        connected_ble_devices* connected_ble_ptr;

        //Check if already added
        for(int i = 0; i<CONFIG_BT_MAX_CONN; i++)
        {
                if(connected_ble_device[i].free == false)
                {
                        if(!strcmp(addr, connected_ble_device[i].addr))
                        {
                                LOG_DBG("Connection already exsists");
                                return 1;
                        }
                }
        }

        err = ble_conn_mgr_get_free_conn(&connected_ble_ptr);

        if(err)
        {
                LOG_ERR("No free connections");
                return err;
        }

        memcpy(connected_ble_ptr->addr, addr, DEVICE_ADDR_LEN);
        memcpy(connected_ble_ptr->addr_type, addr_type, DEVICE_ADDR_TYPE_LEN);
        connected_ble_ptr->free = false;

        LOG_INF("Ble conn added to manager");
        return err;

}

u8_t ble_conn_set_connected(char* addr, bool connected)
{

        int err = 0;
        connected_ble_devices* connected_ble_ptr;

        err = ble_conn_mgr_get_conn_by_addr(addr, &connected_ble_ptr);

        if(err)
        {
                LOG_ERR("Conn not found");
                return err;
        }

        if(connected)
        {
                connected_ble_ptr->connected = true;
        }
        else
        {
                connected_ble_ptr->connected = false;
        }
        LOG_INF("Conn updated");
        return err;

}

u8_t ble_conn_set_disconnected(char* addr)
{
        int err = 0;
        connected_ble_devices* connected_ble_ptr;

        err = ble_conn_mgr_get_conn_by_addr(addr, &connected_ble_ptr);

        if(err)
        {
                LOG_ERR("Can't find conn to disconnect");
                return err;
        }


        connected_ble_ptr->connected = false;
        connected_ble_ptr->discovered = false; //Should we need to discover again on reconnect?
        connected_ble_ptr->num_pairs = 0;
        connected_ble_ptr->shadow_updated = false;
        //connected_ble_ptr->added_to_whitelist = false;
        LOG_INF("Conn Disconnected");
        return err;
}

u8_t ble_conn_mgr_rediscover(char* addr)
{

        int err = 0;
        connected_ble_devices* connected_ble_ptr;

        err = ble_conn_mgr_get_conn_by_addr(addr, &connected_ble_ptr);

        if(err)
        {
                LOG_ERR("Can't find conn to disconnect");
                return err;
        }

        if(!connected_ble_ptr->discovering)
        {
            connected_ble_ptr->discovered = false; //Should we need to discover again on reconnect?
            connected_ble_ptr->num_pairs = 0;
        }

}

u8_t ble_conn_mgr_remove_conn(char* addr)
{
        int err = 0;
        connected_ble_devices* connected_ble_ptr;

        err = ble_conn_mgr_get_conn_by_addr(addr, &connected_ble_ptr);

        if(err)
        {
                LOG_ERR("Can't find conn to remove");
                return err;
        }

        memset(connected_ble_ptr, 0, sizeof(connected_ble_devices));

        connected_ble_ptr->free = true;
        connected_ble_ptr->connected = false;
        connected_ble_ptr->discovered = false;
        LOG_INF("Conn Removed");
        return err;
}


u8_t ble_conn_mgr_get_free_conn(connected_ble_devices** conn_ptr)
{

        for(int i = 0; i<CONFIG_BT_MAX_CONN; i++)
        {
                if(connected_ble_device[i].free == true)
                {
                        *conn_ptr = &connected_ble_device[i];
                        LOG_DBG("Found Free connection: %d", i);
                        return 0;
                }
        }

        return 1;
}


u8_t ble_conn_mgr_get_conn_by_addr(char* addr, connected_ble_devices** conn_ptr)
{

        int err = 0;


        for(int i = 0; i<CONFIG_BT_MAX_CONN; i++)
        {
                if(!strcmp(addr, connected_ble_device[i].addr))
                {
                        *conn_ptr = &connected_ble_device[i];
                        LOG_DBG("Conn Found");
                        return 0;
                }
        }

        LOG_ERR("No Conn Found");
        return 1;

}

u8_t ble_conn_mgr_set_subscribed(u16_t handle, u8_t sub_index, connected_ble_devices* conn_ptr)
{

        for(int i=0; i< conn_ptr->num_pairs; i++)
        {
                if(handle == conn_ptr->uuid_handle_pair[i].handle)
                {
                        conn_ptr->uuid_handle_pair[i].sub_enabled = true;
                        conn_ptr->uuid_handle_pair[i].sub_index = sub_index;

                        return 0;
                }
        }

        return 1;
}


u8_t ble_conn_mgr_remove_subscribed(u16_t handle, connected_ble_devices* conn_ptr)
{

        for(int i=0; i< conn_ptr->num_pairs; i++)
        {
                if(handle == conn_ptr->uuid_handle_pair[i].handle)
                {
                        conn_ptr->uuid_handle_pair[i].sub_enabled = false;
                        return 0;
                }
        }

        return 1;
}


u8_t ble_conn_mgr_get_subscribed(u16_t handle, connected_ble_devices* conn_ptr, bool* status, u8_t* sub_index)
{

        for(int i=0; i< conn_ptr->num_pairs; i++)
        {
                if(handle == conn_ptr->uuid_handle_pair[i].handle)
                {
                        *status = conn_ptr->uuid_handle_pair[i].sub_enabled;
                        *sub_index = conn_ptr->uuid_handle_pair[i].sub_index;
                        return 0;
                }
        }

        return 1;
}

u8_t ble_conn_mgr_get_uuid_by_handle(u16_t handle, char* uuid, connected_ble_devices* conn_ptr)
{

        char uuid_str[BT_UUID_STR_LEN];

        memset(uuid, 0, BT_UUID_STR_LEN);

        for(int i=0; i< conn_ptr->num_pairs; i++)
        {
                if(handle == conn_ptr->uuid_handle_pair[i].handle)
                {
                        bt_uuid_get_str(&conn_ptr->uuid_handle_pair[i].uuid_128.uuid, uuid_str, BT_MAX_UUID_LEN);
                        bt_to_upper(uuid_str, strlen(uuid_str));
                        memcpy(uuid, uuid_str, strlen(uuid_str));
                        LOG_INF("Found UUID: %s For Handle: %d", uuid_str, handle);
                        return 0;
                }
        }

        LOG_ERR("Handle Not Found");

        return 1;

}


u8_t ble_conn_mgr_get_handle_by_uuid(u16_t* handle, char* uuid, connected_ble_devices* conn_ptr)
{

        char str[BT_UUID_STR_LEN];

        LOG_DBG("Num Pairs: %d", conn_ptr->num_pairs);

        for(int i=0; i< conn_ptr->num_pairs; i++)
        {

                bt_uuid_get_str(&conn_ptr->uuid_handle_pair[i].uuid_16.uuid, str, sizeof(str));
                bt_to_upper(str, strlen(str));
                LOG_DBG("UUID IN: %s UUID FOUND: %s", uuid, str);

                if(!strcmp(uuid, str))
                {
                        *handle = conn_ptr->uuid_handle_pair[i].handle;
                        LOG_DBG("16 Bit UUID Found");
                        return 0;
                }

                bt_uuid_get_str(&conn_ptr->uuid_handle_pair[i].uuid_128.uuid, str, sizeof(str));
                bt_to_upper(str, strlen(str));
                LOG_DBG("UUID IN: %s UUID FOUND: %s", uuid, str);
                if(!strcmp(uuid, str))
                {
                        *handle = conn_ptr->uuid_handle_pair[i].handle;
                        LOG_DBG("128 Bit UUID Found");
                        return 0;
                }

        }

        LOG_ERR("Handle Not Found");

        return 1;
}

u8_t ble_conn_mgr_add_uuid_pair(struct bt_uuid *uuid, u16_t handle, u8_t path_depth, u8_t properties, u8_t attr_type, connected_ble_devices* conn_ptr, bool is_service)
{

        int err = 0;

        char str[BT_UUID_STR_LEN];

        if(conn_ptr->num_pairs >= MAX_UUID_PAIRS)
        {
                LOG_ERR("Max uuid pair limit reached");
                return 1;
        }

        LOG_INF("Handle Added: %d", handle);

        if (!uuid) {

                return NULL;
        }

        switch (uuid->type) {
        case BT_UUID_TYPE_16:
                memcpy(&conn_ptr->uuid_handle_pair[conn_ptr->num_pairs].uuid_16, BT_UUID_16(uuid), sizeof(struct bt_uuid_16));
                conn_ptr->uuid_handle_pair[conn_ptr->num_pairs].uuid_type = BT_UUID_TYPE_16;
                bt_uuid_get_str(&conn_ptr->uuid_handle_pair[conn_ptr->num_pairs].uuid_16.uuid, str, sizeof(str));

                LOG_DBG("\tCONN MGR Characteristic: 0x%s",str);
                break;
        case BT_UUID_TYPE_128:
                memcpy(&conn_ptr->uuid_handle_pair[conn_ptr->num_pairs].uuid_128, BT_UUID_128(uuid), sizeof(struct bt_uuid_128));
                conn_ptr->uuid_handle_pair[conn_ptr->num_pairs].uuid_type = BT_UUID_TYPE_128;
                bt_uuid_get_str(&conn_ptr->uuid_handle_pair[conn_ptr->num_pairs].uuid_128.uuid, str, sizeof(str));

                LOG_DBG("\tCONN MGR Characteristic: 0x%s",str);
                break;
        default:

                return NULL;
        }

        conn_ptr->uuid_handle_pair[conn_ptr->num_pairs].properties = properties;
        conn_ptr->uuid_handle_pair[conn_ptr->num_pairs].attr_type = attr_type;
        conn_ptr->uuid_handle_pair[conn_ptr->num_pairs].path_depth = path_depth;
        conn_ptr->uuid_handle_pair[conn_ptr->num_pairs].is_service = is_service;
        conn_ptr->uuid_handle_pair[conn_ptr->num_pairs].handle = handle;

        conn_ptr->num_pairs++;

        return err;
}

void ble_conn_mgr_init()
{

        for(int i = 0; i<CONFIG_BT_MAX_CONN; i++)
        {
                connected_ble_device[i].free = true;
                connected_ble_device[i].added_to_whitelist = false;
                connected_ble_device[i].connected = false;
                connected_ble_device[i].discovered = false;
                connected_ble_device[i].encode_discovered = false;
                connected_ble_device[i].disconnect = false;

        }

}
```
