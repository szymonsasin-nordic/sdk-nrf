## boards/arm/nrf52840_aprgw/Kconfig.board
```kconfig
# Kconfig - nRF52840 PCA20035 board configuration
#
# Copyright (c) 2019 Nordic Semiconductor ASA
#
# SPDX-License-Identifier: LicenseRef-BSD-5-Clause-Nordic

config BOARD_NRF52840_APRGW
	bool "nRF52840 APRGW"
	depends on SOC_NRF52840_QIAA
```

## boards/arm/nrf52840_aprgw/Kconfig.defconfig
```kconfig
# Kconfig - nRF52840 PCA20035 board configuration
#
# Copyright (c) 2019 Nordic Semiconductor ASA
#
# SPDX-License-Identifier: LicenseRef-BSD-5-Clause-Nordic

if BOARD_NRF52840_APRGW

config BOARD
	default "nrf52840_aprgw"

config BT_CTLR
	default BT

if USB

config USB_NRF52840
	def_bool y

config USB_DEVICE_STACK
	def_bool y

endif # USB

endif # BOARD_NRF52840_APRGW
```

## boards/arm/nrf9160_aprgw/Kconfig.board
```kconfig
# Kconfig - nRF91 APRGW board configuration
#
# Copyright (c) 2019 Nordic Semiconductor ASA
#
# SPDX-License-Identifier: LicenseRef-BSD-5-Clause-Nordic

if SOC_NRF9160_SICA

config BOARD_NRF9160_APRGW
	bool "nRF9160 APRGW"
	depends on !TRUSTED_EXECUTION_NONSECURE

config BOARD_NRF9160_APRGWNS
	bool "nRF9160 APRGW non-secure"
	depends on TRUSTED_EXECUTION_NONSECURE

endif # SOC_NRF9160_SICA
```

## samples/nrf9160/aws_iot/Kconfig
```kconfig
#
# Copyright (c) 2020 Nordic Semiconductor ASA
#
# SPDX-License-Identifier: LicenseRef-Nordic-5-Clause
#

menu "AWS IoT Sample Settings"

config APP_VERSION
	string "Application version"
	default "v1.0.0"

config PUBLICATION_INTERVAL_SECONDS
	int "Interval in seconds that the sample will publish data"
	default 60

config CONNECTION_RETRY_TIMEOUT_SECONDS
	int "Number of seconds between each AWS IoT connection retry"
	default 30

config APP_SUBSCRIPTION_TOPIC_1
	string "First topic to subscribe to"
	default "my-custom-topic/example"

config APP_SUBSCRIPTION_TOPIC_2
	string "Second topic to subscribe to"
	default "my-custom-topic/example_2"

config APP_PUBLISH_TOPIC
	string "App topic to publish to"
	default ""

config APP_PUBLISH_MESSAGE
	string "Message to publish to app topic"
	default ""

config APP_PUBLISH_VER_TO_SHADOW
	bool "Publish version to shadow to verify FOTA update worked"
	default y

config APP_PUBLISH_DATA_TO_SHADOW
	bool "Send data to shadow every PUBLICATION_INTERVAL_SECONDS"
	default y

config APP_STAGE
	string "nRF Cloud stage"
	default "prod"

config APP_TENANT
	string "User tenant ID"
	default ""

endmenu

menu "Zephyr Kernel"
source "Kconfig.zephyr"

endmenu

module = AWS_IOT_CLIENT
module-str = AWS IoT Client
source "subsys/logging/Kconfig.template.log_config"
```

## subsys/net/lib/nrf_cloud/Kconfig.nrf_cloud_coap
```kconfig
# Copyright (c) 2023 Nordic Semiconductor
#
# SPDX-License-Identifier: LicenseRef-Nordic-5-Clause
#

menuconfig NRF_CLOUD_COAP
	bool "nRF Cloud COAP"
	select CJSON_LIB
	select ZCBOR
	select COAP
	select COAP_EXTENDED_OPTIONS_LEN
	select COAP_CLIENT

if NRF_CLOUD_COAP

config NRF_CLOUD_COAP_SERVER_HOSTNAME
	string "CoAP server hostname"
	default "coap.dev.nrfcloud.com"

menuconfig NRF_CLOUD_COAP_DTLS
	bool "CoAP client with DTLS support"
	help
	  If y, use together with either overlay-mbedtls.conf or
	  overlay-offload-tls.conf.

if NRF_CLOUD_COAP_DTLS

config NRF_CLOUD_COAP_DTLS_CID
	bool "Connection ID support"
	help
	  If y, use CID socket options.

config NRF_CLOUD_COAP_DTLS_PSK
	bool "DTLS using Pre-Shared Keys"
	help
	  If y, use PSKs for security.  If n, use CA certificate + JWT.

if NRF_CLOUD_COAP_DTLS_PSK

config COAP_DTLS_PSK_IDENTITY
	string "DTLS Preshared Key Identity"
	default ""
	# default "n3526561061234690123456789abcdef"

config COAP_DTLS_PSK_SECRET
	string "DTLS Preshared Key Secret"
	default ""
	# default "000102030405060708090a0b0c0d0e0f"

endif
endif

config NRF_CLOUD_COAP_SEC_TAG
	int "Security tag in which to store credentials"
	default 86

config NRF_CLOUD_COAP_THREAD_STACK_SIZE
	int "Stack size for CoAP reception thread"
	default 4096

config NRF_CLOUD_COAP_SERVER_PORT
	int "CoAP server port"
	default 5684 if NRF_CLOUD_COAP_DTLS
	default 5683

module = NRF_CLOUD_COAP
module-str = nRF Cloud COAP
source "subsys/logging/Kconfig.template.log_config"

endif # NRF_CLOUD_COAP
```
